// Host tests for the StarDict reader: DictionaryRegistry (folder discovery and
// path safety), the sidecar index build, lookup (exact / case / synonym / stem),
// the prefix search for runs of CJK text, every entry of a word, and the
// dictzip random-access path.
//
// The fixture under test/fixtures/dictionary is generated by make_fixture.py in
// that directory; it holds two copies of the same dictionary, one with a plain
// .dict and one with a real dictzip .dict.dz, so the compressed path can be
// asserted against the uncompressed one rather than against hand-copied bytes.

#include <BuildArena.h>
#include <InflateReader.h>
#include <gtest/gtest.h>

#include <algorithm>
#include <cstdint>
#include <cstdio>
#include <filesystem>
#include <fstream>
#include <string>
#include <utility>
#include <vector>

#include "../book_metadata_cache/AllocationRefusal.h"
#include "Dictionary.h"
#include "DictionaryRegistry.h"
#include "StringUtils.h"
#include "Utf8.h"

namespace fs = std::filesystem;

namespace {

const fs::path kFixtureDir = DICT_FIXTURE_DIR;
const fs::path kSdRoot = DICT_TEST_ROOT;
const fs::path kDictRoot = kSdRoot / "dictionaries";
const fs::path kHiddenRoot = kSdRoot / ".dictionaries";

std::string readWholeFile(const fs::path& path) {
  std::ifstream in(path, std::ios::binary);
  return std::string((std::istreambuf_iterator<char>(in)), std::istreambuf_iterator<char>());
}

void writeWholeFile(const fs::path& path, const std::string& data) {
  fs::create_directories(path.parent_path());
  std::ofstream out(path, std::ios::binary | std::ios::trunc);
  out.write(data.data(), static_cast<std::streamsize>(data.size()));
}

uint32_t readBe32(const uint8_t* p) {
  return (static_cast<uint32_t>(p[0]) << 24) | (static_cast<uint32_t>(p[1]) << 16) |
         (static_cast<uint32_t>(p[2]) << 8) | static_cast<uint32_t>(p[3]);
}

// One .idx entry, as the test needs it to predict what a lookup must return.
struct IndexEntry {
  std::string word;
  uint32_t offset = 0;
  uint32_t size = 0;
};

// Parse a whole .idx. The test derives its expectations from the fixture rather
// than from constants copied alongside it, so regenerating the fixture with
// different words cannot silently stop testing anything.
std::vector<IndexEntry> parseIdx(const fs::path& path) {
  const std::string blob = readWholeFile(path);
  std::vector<IndexEntry> entries;
  size_t pos = 0;
  while (pos < blob.size()) {
    const size_t nul = blob.find('\0', pos);
    if (nul == std::string::npos || nul + 9 > blob.size()) break;
    IndexEntry e;
    e.word = blob.substr(pos, nul - pos);
    const auto* suffix = reinterpret_cast<const uint8_t*>(blob.data() + nul + 1);
    e.offset = readBe32(suffix);
    e.size = readBe32(suffix + 4);
    entries.push_back(std::move(e));
    pos = nul + 9;
  }
  return entries;
}

// Copy one generated dictionary into the SD root under a fresh folder name, so
// a test that writes sidecars or corrupts a file cannot disturb its neighbours.
// Returns the folder name to hand to Dictionary::open().
std::string provision(const std::string& fixtureFolder, const std::string& asFolder, bool hidden = false) {
  const fs::path dest = (hidden ? kHiddenRoot : kDictRoot) / asFolder;
  fs::remove_all(dest);
  fs::create_directories(dest);
  for (const auto& e : fs::directory_iterator(kFixtureDir / fixtureFolder)) {
    fs::copy_file(e.path(), dest / e.path().filename(), fs::copy_options::overwrite_existing);
  }
  return asFolder;
}

// A hand-built dictionary for the lookup-rule tests, which need headwords the
// generated fixture does not carry (case variants, umlauts, elisions).
struct HeadwordSpec {
  std::string word;
  std::string definition;
};
struct SynonymSpec {
  std::string word;
  std::string headword;  // must be one of the dictionary's headwords
  int occurrence = 0;    // which of several equal headwords it points at, in .idx order
};

// StarDict's own order: g_ascii_strcasecmp, ties broken by strcmp.
bool stardictLess(const std::string& a, const std::string& b) {
  const int c = StringUtils::asciiCaseCmp(a.c_str(), b.c_str());
  return c != 0 ? c < 0 : a < b;
}

void appendBe32(std::string& out, uint32_t v) {
  const char bytes[4] = {static_cast<char>(v >> 24), static_cast<char>(v >> 16), static_cast<char>(v >> 8),
                         static_cast<char>(v)};
  out.append(bytes, sizeof(bytes));
}

// Write an uncompressed dictionary (plus a .syn when synonyms are given) under
// /dictionaries/<folder>, both indexes sorted the way StarDict sorts them.
// Byte-equal headwords keep the order the test gives them.
void writeDictionary(const std::string& folder, std::vector<HeadwordSpec> headwords,
                     std::vector<SynonymSpec> synonyms = {}, const std::string& sametypesequence = "m") {
  std::stable_sort(headwords.begin(), headwords.end(),
                   [](const HeadwordSpec& a, const HeadwordSpec& b) { return stardictLess(a.word, b.word); });
  std::stable_sort(synonyms.begin(), synonyms.end(),
                   [](const SynonymSpec& a, const SynonymSpec& b) { return stardictLess(a.word, b.word); });
  std::string idx;
  std::string dict;
  for (const auto& h : headwords) {
    idx += h.word;
    idx += '\0';
    appendBe32(idx, static_cast<uint32_t>(dict.size()));
    appendBe32(idx, static_cast<uint32_t>(h.definition.size()));
    dict += h.definition;
  }
  std::string syn;
  for (const auto& s : synonyms) {
    size_t ordinal = headwords.size();
    int seen = 0;
    for (size_t i = 0; i < headwords.size(); i++) {
      if (headwords[i].word == s.headword && seen++ == s.occurrence) {
        ordinal = i;
        break;
      }
    }
    ASSERT_NE(ordinal, headwords.size()) << "synonym " << s.word << " names no headword";
    syn += s.word;
    syn += '\0';
    appendBe32(syn, static_cast<uint32_t>(ordinal));
  }
  const fs::path dir = kDictRoot / folder;
  fs::remove_all(dir);
  writeWholeFile(dir / "words.idx", idx);
  writeWholeFile(dir / "words.dict", dict);
  writeWholeFile(dir / "words.ifo", "StarDict's dict ifo file\nsametypesequence=" + sametypesequence + "\n");
  if (!syn.empty()) writeWholeFile(dir / "words.syn", syn);
}

// open() + buildIndex(), the sequence every caller runs before a first lookup.
void openIndexed(Dictionary& dict, const std::string& folder) {
  ASSERT_TRUE(dict.open(folder.c_str())) << folder;
  Dictionary::IndexResult indexResult = Dictionary::IndexResult::ReadError;
  ASSERT_TRUE(dict.buildIndex(nullptr, nullptr, &indexResult));
  ASSERT_EQ(indexResult, Dictionary::IndexResult::Ok);
}

class DictionaryTest : public ::testing::Test {
 protected:
  static void SetUpTestSuite() {
    fs::remove_all(kSdRoot);
    fs::create_directories(kDictRoot);
    fs::create_directories(kHiddenRoot);
    plainEntries = parseIdx(kFixtureDir / "plain" / "plain.idx");
    plainDictBlob = readWholeFile(kFixtureDir / "plain" / "plain.dict");
    ASSERT_FALSE(plainEntries.empty());
    ASSERT_FALSE(plainDictBlob.empty());
  }

  // The definition text the index says belongs to `word`, straight out of the
  // uncompressed fixture .dict.
  static std::string expectedDefinition(const std::string& word) {
    for (const auto& e : plainEntries) {
      if (e.word == word) return plainDictBlob.substr(e.offset, e.size);
    }
    ADD_FAILURE() << "fixture has no headword " << word;
    return {};
  }

  static std::vector<IndexEntry> plainEntries;
  static std::string plainDictBlob;
};

std::vector<IndexEntry> DictionaryTest::plainEntries;
std::string DictionaryTest::plainDictBlob;

// --- registry ---------------------------------------------------------------

TEST_F(DictionaryTest, DiscoverFindsBothRootsAndSkipsUnusableFolders) {
  provision("plain", "Alpha");
  provision("zipped", "Beta");
  provision("plain", "HiddenOne", /*hidden=*/true);

  // Index but no data: unusable, and surfacing it would mean a dictionary that
  // fails only once the user looks a word up.
  writeWholeFile(kDictRoot / "NoData" / "nodata.idx", "x");
  // Two distinct stems: which one is "the" dictionary is undecidable.
  writeWholeFile(kDictRoot / "Ambiguous" / "one.idx", "x");
  writeWholeFile(kDictRoot / "Ambiguous" / "one.dict", "x");
  writeWholeFile(kDictRoot / "Ambiguous" / "two.idx", "x");
  // macOS AppleDouble sidecar next to a real index must not count as a stem.
  provision("plain", "Gamma");
  writeWholeFile(kDictRoot / "Gamma" / "._plain.idx", "x");
  // A dot-folder is hidden from the browser and skipped by the scan.
  writeWholeFile(kDictRoot / ".Skipped" / "s.idx", "x");
  writeWholeFile(kDictRoot / ".Skipped" / "s.dict", "x");

  std::vector<DictionaryEntry> found;
  DictionaryRegistry::discover(found);

  std::vector<std::string> names;
  for (const auto& e : found) names.push_back(e.name);
  EXPECT_EQ(names, (std::vector<std::string>{"Alpha", "Beta", "Gamma", "HiddenOne"}));
  ASSERT_FALSE(found.empty());
  EXPECT_EQ(found[0].stem, "plain");
  EXPECT_EQ(found[1].stem, "zipped");
}

TEST_F(DictionaryTest, ResolveBasePathRejectsEscapesAndMissingFolders) {
  provision("plain", "Alpha");
  std::string base;
  EXPECT_TRUE(DictionaryRegistry::resolveBasePath("Alpha", base));
  // generic_string(), not string(): resolveBasePath() joins with '/' on every
  // platform because it builds SD/FAT paths, but fs::path::operator/ inserts
  // the host's preferred separator, which is '\' on Windows. string() would
  // therefore expect "sdroot\dictionaries\Alpha\plain" and fail there while
  // passing on Linux. generic_string() always renders '/', so the expectation
  // matches what the firmware actually produces.
  EXPECT_EQ(base, (kDictRoot / "Alpha" / "plain").generic_string());

  // The folder name comes out of the settings JSON, so a crafted value must not
  // be able to walk out of the dictionary roots.
  EXPECT_FALSE(DictionaryRegistry::resolveBasePath("../secrets", base));
  EXPECT_FALSE(DictionaryRegistry::resolveBasePath("Alpha/plain", base));
  EXPECT_FALSE(DictionaryRegistry::resolveBasePath("..", base));
  EXPECT_FALSE(DictionaryRegistry::resolveBasePath(".hidden", base));
  EXPECT_FALSE(DictionaryRegistry::resolveBasePath("", base));
  EXPECT_FALSE(DictionaryRegistry::resolveBasePath(nullptr, base));
  EXPECT_FALSE(DictionaryRegistry::resolveBasePath("NoSuchFolder", base));
}

// --- open / .ifo ------------------------------------------------------------

TEST_F(DictionaryTest, OpenRejectsSixtyFourBitOffsets) {
  const std::string folder = provision("plain", "Wide");
  const fs::path ifo = kDictRoot / folder / "plain.ifo";
  writeWholeFile(ifo, readWholeFile(ifo) + "idxoffsetbits=64\n");

  Dictionary dict;
  EXPECT_FALSE(dict.open(folder.c_str()));
  EXPECT_FALSE(dict.isOpen());
}

TEST_F(DictionaryTest, HtmlDefinitionsFollowSametypesequence) {
  const std::string plainFolder = provision("plain", "PlainTypes");
  Dictionary plain;
  ASSERT_TRUE(plain.open(plainFolder.c_str()));
  EXPECT_FALSE(plain.definitionsAreHtml());

  const std::string htmlFolder = provision("plain", "HtmlTypes");
  const fs::path ifo = kDictRoot / htmlFolder / "plain.ifo";
  std::string text = readWholeFile(ifo);
  const size_t at = text.find("sametypesequence=m");
  ASSERT_NE(at, std::string::npos);
  text.replace(at, std::string("sametypesequence=m").size(), "sametypesequence=h");
  writeWholeFile(ifo, text);

  Dictionary html;
  ASSERT_TRUE(html.open(htmlFolder.c_str()));
  EXPECT_TRUE(html.definitionsAreHtml());
}

TEST_F(DictionaryTest, OpenFailsWithoutDictData) {
  fs::remove_all(kDictRoot / "IndexOnly");
  writeWholeFile(kDictRoot / "IndexOnly" / "x.idx", std::string("word", 4) + std::string(9, '\0'));
  Dictionary dict;
  EXPECT_FALSE(dict.open("IndexOnly"));
}

// --- index build ------------------------------------------------------------

TEST_F(DictionaryTest, BuildIndexWritesSidecarsAndIsIdempotent) {
  const std::string folder = provision("plain", "Indexing");
  const fs::path qidx = kDictRoot / folder / "plain.qidx";
  const fs::path sidx = kDictRoot / folder / "plain.sidx";

  Dictionary dict;
  ASSERT_TRUE(dict.open(folder.c_str()));
  EXPECT_TRUE(dict.needsIndex());
  EXPECT_FALSE(fs::exists(qidx));

  ASSERT_TRUE(dict.buildIndex());
  EXPECT_TRUE(fs::exists(qidx));
  EXPECT_TRUE(fs::exists(sidx));
  EXPECT_FALSE(dict.needsIndex());

  // A second pass must not rewrite a fresh sidecar -- the .idx scan is the slow
  // first-use cost the sidecar exists to pay only once.
  const auto qidxWritten = fs::last_write_time(qidx);
  const std::string before = readWholeFile(qidx);
  ASSERT_TRUE(dict.buildIndex());
  EXPECT_EQ(fs::last_write_time(qidx), qidxWritten);
  EXPECT_EQ(readWholeFile(qidx), before);
}

TEST_F(DictionaryTest, SidecarIsRebuiltWhenTheIndexChangesSize) {
  const std::string folder = provision("plain", "Restale");
  Dictionary dict;
  ASSERT_NO_FATAL_FAILURE(openIndexed(dict, folder));
  EXPECT_FALSE(dict.needsIndex());

  const fs::path idx = kDictRoot / folder / "plain.idx";
  writeWholeFile(idx, readWholeFile(idx) + std::string(9, '\0'));

  Dictionary reopened;
  ASSERT_TRUE(reopened.open(folder.c_str()));
  EXPECT_TRUE(reopened.needsIndex());
}

// --- lookup -----------------------------------------------------------------

TEST_F(DictionaryTest, ExactLookupsAcrossTheWholeIndex) {
  const std::string folder = provision("plain", "Exact");
  Dictionary dict;
  ASSERT_NO_FATAL_FAILURE(openIndexed(dict, folder));

  // First, last and a spread of interior entries: the interior ones are what
  // force a real descent through the sampled sidecar.
  std::vector<size_t> probes = {0, 1, plainEntries.size() / 2, plainEntries.size() - 1};
  for (size_t i = 0; i < plainEntries.size(); i += 137) probes.push_back(i);

  for (size_t i : probes) {
    const IndexEntry& entry = plainEntries[i];
    std::string definition;
    std::string headword;
    Dictionary::LookupResult result = Dictionary::LookupResult::NotFound;
    ASSERT_TRUE(dict.lookup(entry.word.c_str(), definition, headword, &result))
        << "entry " << i << " (" << entry.word << ")";
    EXPECT_EQ(result, Dictionary::LookupResult::Found);
    EXPECT_EQ(headword, entry.word);
    EXPECT_EQ(definition, plainDictBlob.substr(entry.offset, entry.size));
  }
}

TEST_F(DictionaryTest, LookupIsCaseInsensitive) {
  const std::string folder = provision("plain", "Casing");
  Dictionary dict;
  ASSERT_NO_FATAL_FAILURE(openIndexed(dict, folder));

  std::string definition;
  std::string headword;
  ASSERT_TRUE(dict.lookup("QUIXOTIC", definition, headword));
  EXPECT_EQ(headword, "quixotic");
  EXPECT_EQ(definition, expectedDefinition("quixotic"));

  // A capitalised headword found through a lowercase query -- the case that
  // plain strcmp ordering would put on the wrong page of the index.
  definition.clear();
  ASSERT_TRUE(dict.lookup("quorum", definition, headword));
  EXPECT_EQ(headword, "Quorum");
  EXPECT_EQ(definition, expectedDefinition("Quorum"));
}

TEST_F(DictionaryTest, MissReportsNotFoundRatherThanAFailure) {
  const std::string folder = provision("plain", "Missing");
  Dictionary dict;
  ASSERT_NO_FATAL_FAILURE(openIndexed(dict, folder));

  std::string definition;
  std::string headword;
  Dictionary::LookupResult result = Dictionary::LookupResult::Found;
  EXPECT_FALSE(dict.lookup("zzzzzzzznotaword", definition, headword, &result));
  EXPECT_EQ(result, Dictionary::LookupResult::NotFound);

  // Before the first entry and after the last: the two ends the descent has to
  // clamp rather than run off.
  EXPECT_FALSE(dict.lookup("AAAAAAAA", definition, headword, &result));
  EXPECT_EQ(result, Dictionary::LookupResult::NotFound);
  EXPECT_FALSE(dict.lookup("zzzzzzzz", definition, headword, &result));
  EXPECT_EQ(result, Dictionary::LookupResult::NotFound);
}

TEST_F(DictionaryTest, StemVariantsResolveToTheirHeadword) {
  const std::string folder = provision("plain", "Stemming");
  Dictionary dict;
  ASSERT_NO_FATAL_FAILURE(openIndexed(dict, folder));

  // Every stem probe after the first reuses the sample window the exact-match
  // probe resolved, so run enough of them, spread across the index, to catch a
  // window that is reused when it should not be.
  int checked = 0;
  for (size_t i = 0; i < plainEntries.size(); i += 53) {
    const std::string& word = plainEntries[i].word;
    const std::string inflected = word + "s";
    // Skip if the inflected form is itself a headword: then it is an exact hit
    // and proves nothing about stemming.
    bool inflectedIsHeadword = false;
    for (const auto& e : plainEntries) {
      if (e.word == inflected) inflectedIsHeadword = true;
    }
    if (inflectedIsHeadword) continue;

    std::string definition;
    std::string headword;
    ASSERT_TRUE(dict.lookup(inflected.c_str(), definition, headword)) << inflected;
    EXPECT_EQ(headword, word);
    EXPECT_EQ(definition, plainDictBlob.substr(plainEntries[i].offset, plainEntries[i].size));
    checked++;
  }
  EXPECT_GT(checked, 20);
}

TEST_F(DictionaryTest, HyphenatedCompoundsFallBackToTheirLongestPart) {
  const std::string folder = provision("plain", "Hyphenated");
  Dictionary dict;
  ASSERT_NO_FATAL_FAILURE(openIndexed(dict, folder));

  std::string definition;
  std::string headword;

  // A compound that IS a headword must win outright -- it must not be split and
  // resolved to "being", which would return the wrong entry for a word the
  // dictionary actually has.
  ASSERT_TRUE(dict.lookup("well-being", definition, headword));
  EXPECT_EQ(headword, "well-being");
  EXPECT_EQ(definition, expectedDefinition("well-being"));

  // A compound that is not a headword falls back to its longest part, which is
  // the one carrying the meaning.
  ASSERT_TRUE(dict.lookup("multi-billionaire", definition, headword));
  EXPECT_EQ(headword, "billionaire");
  EXPECT_EQ(definition, expectedDefinition("billionaire"));

  // Longest-first, not head-final: "law" would be the head here and is not in
  // the dictionary, while "mother" is what the reader wants.
  ASSERT_TRUE(dict.lookup("mother-in-law", definition, headword));
  EXPECT_EQ(headword, "mother");

  // The real hyphens EPUB text uses, not just ASCII.
  ASSERT_TRUE(
      dict.lookup("multi\xE2\x80\x91"
                  "billionaire",
                  definition, headword));
  EXPECT_EQ(headword, "billionaire");

  // Surrounding punctuation and case still get cleaned off first.
  ASSERT_TRUE(dict.lookup("(Multi-Billionaire)", definition, headword));
  EXPECT_EQ(headword, "billionaire");

  // A compound whose parts are all absent is still a genuine miss.
  Dictionary::LookupResult result = Dictionary::LookupResult::Found;
  EXPECT_FALSE(dict.lookup("zzzznope-yyyynope", definition, headword, &result));
  EXPECT_EQ(result, Dictionary::LookupResult::NotFound);
}

TEST_F(DictionaryTest, SynonymsResolveThroughTheOrdinalIndex) {
  const std::string folder = provision("plain", "Synonyms");
  Dictionary dict;
  ASSERT_NO_FATAL_FAILURE(openIndexed(dict, folder));

  // "quixotical" is in the .syn only: no stemming rule turns it into
  // "quixotic", so a hit here can only have come through the synonym index and
  // its ordinal -> headword resolution.
  std::string definition;
  std::string headword;
  Dictionary::LookupResult result = Dictionary::LookupResult::NotFound;
  ASSERT_TRUE(dict.lookup("quixotical", definition, headword, &result));
  EXPECT_EQ(result, Dictionary::LookupResult::Found);
  EXPECT_EQ(headword, "quixotic");
  EXPECT_EQ(definition, expectedDefinition("quixotic"));
}

TEST_F(DictionaryTest, ExactCaseHeadwordWinsOverItsCapitalisedVariants) {
  // StarDict sorts case variants capitals first, so a scan that took the first
  // case-insensitive match answered "husk" with the surname.
  ASSERT_NO_FATAL_FAILURE(writeDictionary("CaseRun",
                                          {{"HUSK", "an acronym"},
                                           {"Husk", "a surname"},
                                           {"husk", "the dry outer covering"},
                                           {"Matter", "a surname"},
                                           {"matter", "substance"},
                                           {"Paris", "the capital of France"}},
                                          {{"Husks", "Husk"}, {"husks", "husk"}}));
  Dictionary dict;
  ASSERT_NO_FATAL_FAILURE(openIndexed(dict, "CaseRun"));

  std::string definition;
  std::string headword;
  ASSERT_TRUE(dict.lookup("husk", definition, headword));
  EXPECT_EQ(headword, "husk");
  EXPECT_EQ(definition, "the dry outer covering");
  ASSERT_TRUE(dict.lookup("matter", definition, headword));
  EXPECT_EQ(headword, "matter");
  EXPECT_EQ(definition, "substance");

  // A sentence-initial capital is cleaned away, so it gets the common word too.
  ASSERT_TRUE(dict.lookup("Husk", definition, headword));
  EXPECT_EQ(headword, "husk");

  // A word the dictionary only has capitalised is still found.
  ASSERT_TRUE(dict.lookup("paris", definition, headword));
  EXPECT_EQ(headword, "Paris");
  EXPECT_EQ(definition, "the capital of France");

  // The .syn has the same runs and takes the same rule.
  ASSERT_TRUE(dict.lookup("husks", definition, headword));
  EXPECT_EQ(headword, "husk");
  EXPECT_EQ(definition, "the dry outer covering");
}

TEST_F(DictionaryTest, ExactCaseHeadwordIsFoundWhenItsRunStraddlesASample) {
  // The sidecar samples every 256th entry. Slide a three-entry case run across
  // that boundary so the descent lands before, inside and at the end of it.
  for (int fillers = 253; fillers <= 257; fillers++) {
    std::vector<HeadwordSpec> headwords;
    for (int i = 0; i < fillers; i++) {
      char word[16];
      snprintf(word, sizeof(word), "aaa%03d", i);
      headwords.push_back({word, "filler"});
    }
    headwords.push_back({"HUSK", "an acronym"});
    headwords.push_back({"Husk", "a surname"});
    headwords.push_back({"husk", "the dry outer covering"});
    headwords.push_back({"zebra", "the striped one"});
    const std::string folder = "Straddle" + std::to_string(fillers);
    ASSERT_NO_FATAL_FAILURE(writeDictionary(folder, headwords));
    Dictionary dict;
    ASSERT_NO_FATAL_FAILURE(openIndexed(dict, folder));

    std::string definition;
    std::string headword;
    ASSERT_TRUE(dict.lookup("husk", definition, headword)) << fillers;
    EXPECT_EQ(headword, "husk") << fillers;
    EXPECT_EQ(definition, "the dry outer covering") << fillers;
  }
}

// Asserts that `word` resolves to `headword` and reads back `definition`.
void expectHit(Dictionary& dict, const char* word, const char* headword, const char* definition) {
  std::string gotDefinition;
  std::string gotHeadword;
  ASSERT_TRUE(dict.lookup(word, gotDefinition, gotHeadword)) << word;
  EXPECT_EQ(gotHeadword, headword) << word;
  EXPECT_EQ(gotDefinition, definition) << word;
}

TEST_F(DictionaryTest, CapitalisedNonAsciiWordsFindTheirLowercaseHeadword) {
  ASSERT_NO_FATAL_FAILURE(writeDictionary("Folded", {{"über", "over"},
                                                     {"straße", "street"},
                                                     {"привет", "hello"},
                                                     {"γεια", "hi"},
                                                     {"τους", "them"},
                                                     {"їжак", "hedgehog"},
                                                     {"Ärzte", "doctors"},
                                                     {"ärzte", "a lowercase decoy"},
                                                     {"Москва", "Moscow"}}));
  Dictionary dict;
  ASSERT_NO_FATAL_FAILURE(openIndexed(dict, "Folded"));

  // Sentence-initial and all-caps forms: cleanWord() lowercases only ASCII.
  expectHit(dict, "Über", "über", "over");
  expectHit(dict, "ÜBER", "über", "over");
  expectHit(dict, "STRAẞE", "straße", "street");
  expectHit(dict, "Привет", "привет", "hello");
  expectHit(dict, "ПРИВЕТ", "привет", "hello");
  expectHit(dict, "Γεια", "γεια", "hi");
  expectHit(dict, "ΤΟΥΣ", "τους", "them");  // a word-final sigma lowercases to ς
  expectHit(dict, "Їжак", "їжак", "hedgehog");

  // A headword stored capitalised keeps its exact hit: the lowercase form is
  // only the fallback, so the decoy is never reached.
  expectHit(dict, "Ärzte", "Ärzte", "doctors");
  expectHit(dict, "Москва", "Москва", "Moscow");
}

TEST_F(DictionaryTest, FrenchElisionsFallBackToTheWordAfterTheApostrophe) {
  ASSERT_NO_FATAL_FAILURE(writeDictionary("Elisions", {{"histoire", "story"},
                                                       {"après", "after"},
                                                       {"aime", "loves"},
                                                       {"est", "is"},
                                                       {"été", "summer"},
                                                       {"avant", "before"},
                                                       {"arc-en-ciel", "rainbow"},
                                                       {"d'accord", "agreed"},
                                                       {"accord", "a decoy"},
                                                       {"aujourd'hui", "today"},
                                                       {"brien", "a decoy"}}));
  Dictionary dict;
  ASSERT_NO_FATAL_FAILURE(openIndexed(dict, "Elisions"));

  expectHit(dict, "l'histoire", "histoire", "story");
  expectHit(dict, "l’histoire", "histoire", "story");
  expectHit(dict, "L’Histoire", "histoire", "story");
  expectHit(dict, "qu'après", "après", "after");
  expectHit(dict, "QU’Après", "après", "after");  // and the remainder is lowercased as a fallback
  expectHit(dict, "Lʼété", "été", "summer");      // U+02BC modifier apostrophe
  expectHit(dict, "j'aime", "aime", "loves");
  expectHit(dict, "n’aime", "aime", "loves");
  expectHit(dict, "c’est", "est", "is");
  // The remainder gets the whole probe, stems included, and its hyphen parts.
  expectHit(dict, "d'histoires", "histoire", "story");
  expectHit(dict, "l'arc-en-ciel", "arc-en-ciel", "rainbow");
  expectHit(dict, "d'avant-garde", "avant", "before");  // split from "avant-garde", not "d'avant-garde"

  // A headword that is itself elided wins over its remainder.
  expectHit(dict, "d'accord", "d'accord", "agreed");
  expectHit(dict, "aujourd'hui", "aujourd'hui", "today");

  // Only the French prefixes are stripped, and never down to nothing.
  std::string definition;
  std::string headword;
  Dictionary::LookupResult result = Dictionary::LookupResult::Found;
  EXPECT_FALSE(dict.lookup("O'Brien", definition, headword, &result));
  EXPECT_EQ(result, Dictionary::LookupResult::NotFound);
  EXPECT_FALSE(dict.lookup("l'", definition, headword, &result));
  EXPECT_EQ(result, Dictionary::LookupResult::NotFound);
}

TEST_F(DictionaryTest, ResolveFindsTheLocationWithoutReadingIt) {
  const std::string folder = provision("plain", "Resolving");
  Dictionary dict;
  ASSERT_NO_FATAL_FAILURE(openIndexed(dict, folder));

  // resolve() must agree with the index on both the location and the headword,
  // for exact hits, stemmed hits and synonyms alike -- it is the same search.
  for (size_t i = 0; i < plainEntries.size(); i += 211) {
    const IndexEntry& entry = plainEntries[i];
    DictEntries entries;
    std::string headword;
    Dictionary::LookupResult result = Dictionary::LookupResult::NotFound;
    ASSERT_TRUE(dict.resolve(entry.word.c_str(), entries, headword, &result)) << entry.word;
    EXPECT_EQ(result, Dictionary::LookupResult::Found);
    EXPECT_TRUE(entries.location.found);
    EXPECT_EQ(entries.location.offset, entry.offset);
    EXPECT_EQ(entries.location.size, entry.size);
    EXPECT_EQ(headword, entry.word);

    // And reading that location gives exactly what lookup() would have.
    std::string definition;
    ASSERT_TRUE(dict.readResolved(entries, definition, &result));
    EXPECT_EQ(result, Dictionary::LookupResult::Found);
    EXPECT_EQ(definition, plainDictBlob.substr(entry.offset, entry.size));
  }

  DictEntries synonymEntries;
  std::string synonymHeadword;
  ASSERT_TRUE(dict.resolve("quixotical", synonymEntries, synonymHeadword));
  EXPECT_EQ(synonymHeadword, "quixotic");

  // A miss resolves to nothing and reports a miss, not a failure.
  DictEntries missEntries;
  std::string missHeadword;
  Dictionary::LookupResult missResult = Dictionary::LookupResult::Found;
  EXPECT_FALSE(dict.resolve("zzzzzzzznotaword", missEntries, missHeadword, &missResult));
  EXPECT_EQ(missResult, Dictionary::LookupResult::NotFound);
  EXPECT_FALSE(missEntries.location.found);
}

TEST_F(DictionaryTest, LookupsSucceedWithoutTheSidecar) {
  // No .qidx: locate() must fall back to scanning the index from byte 0 rather
  // than fail, because a dictionary can be used before the indexing pass runs.
  const std::string folder = provision("plain", "Unindexed");
  Dictionary dict;
  ASSERT_TRUE(dict.open(folder.c_str()));
  ASSERT_TRUE(dict.needsIndex());

  std::string definition;
  std::string headword;
  ASSERT_TRUE(dict.lookup("quixotic", definition, headword));
  EXPECT_EQ(definition, expectedDefinition("quixotic"));
}

TEST_F(DictionaryTest, ReleaseCachesLeavesTheDictionaryUsable) {
  const std::string folder = provision("plain", "Recycled");
  Dictionary dict;
  ASSERT_NO_FATAL_FAILURE(openIndexed(dict, folder));

  std::string definition;
  std::string headword;
  ASSERT_TRUE(dict.lookup("quixotic", definition, headword));
  dict.releaseCaches();
  // The session buffers are gone; the next lookup has to take them again.
  definition.clear();
  ASSERT_TRUE(dict.lookup("quixotic", definition, headword));
  EXPECT_EQ(definition, expectedDefinition("quixotic"));
}

// Base paths longer than the 151 chars a fixed 160-byte path buffer once left, on the card itself:
// a folder name the registry can list (under 128 bytes) and a long stem. Every folder of this suite
// hit the same limit when the build directory was long.
TEST_F(DictionaryTest, LongFolderAndStemNamesAreLookedUp) {
  for (const std::string kind : {"plain", "zipped"}) {
    const std::string folder = kind + std::string(110, 'F');
    const std::string stem(60, 'S');
    const fs::path dest = kDictRoot / folder;
    fs::remove_all(dest);
    fs::create_directories(dest);
    for (const auto& e : fs::directory_iterator(kFixtureDir / kind)) {
      // plain.idx becomes SSS...S.idx, zipped.dict.dz SSS...S.dict.dz.
      fs::copy_file(e.path(), dest / (stem + e.path().filename().string().substr(kind.size())));
    }
    ASSERT_GT(("/dictionaries/" + folder + "/" + stem).size(), 151u);

    Dictionary dict;
    ASSERT_NO_FATAL_FAILURE(openIndexed(dict, folder));
    std::string definition;
    std::string headword;
    ASSERT_TRUE(dict.lookup("quixotic", definition, headword)) << kind;
    EXPECT_EQ(definition, expectedDefinition("quixotic")) << kind;
  }
}

// --- dictzip ----------------------------------------------------------------

TEST_F(DictionaryTest, CompressedDictionaryMatchesThePlainOneByteForByte) {
  const std::string folder = provision("zipped", "Zipped");
  Dictionary dict;
  ASSERT_NO_FATAL_FAILURE(openIndexed(dict, folder));

  // Spread the probes so definitions land at chunk starts, chunk middles and
  // across chunk boundaries.
  for (size_t i = 0; i < plainEntries.size(); i += 29) {
    const IndexEntry& entry = plainEntries[i];
    std::string definition;
    std::string headword;
    ASSERT_TRUE(dict.lookup(entry.word.c_str(), definition, headword)) << entry.word;
    EXPECT_EQ(definition, plainDictBlob.substr(entry.offset, entry.size)) << entry.word;
  }
}

TEST_F(DictionaryTest, MultiChunkDefinitionIsReassembledInOrder) {
  const std::string folder = provision("zipped", "ZippedLong");
  Dictionary dict;
  ASSERT_NO_FATAL_FAILURE(openIndexed(dict, folder));

  const std::string expected = expectedDefinition("longword");
  // The fixture's chunk length is 4096, so this definition must span several
  // chunks -- otherwise the test is not exercising the chunk loop at all.
  ASSERT_GT(expected.size(), 4096u * 3);

  std::string definition;
  std::string headword;
  ASSERT_TRUE(dict.lookup("longword", definition, headword));
  EXPECT_EQ(definition, expected);
}

TEST_F(DictionaryTest, CorruptCompressedDataFailsWithoutClaimingAMiss) {
  const std::string folder = provision("zipped", "ZippedCorrupt");
  Dictionary dict;
  ASSERT_NO_FATAL_FAILURE(openIndexed(dict, folder));

  // Truncate the compressed data, leaving the header and its chunk table intact.
  // The last headword's bytes live in the final chunk, so its compressed data is
  // certainly gone. The index still says the entry is there, so a failure here
  // must be named as a failure, not reported as "not found".
  const fs::path dz = kDictRoot / folder / "zipped.dict.dz";
  std::string blob = readWholeFile(dz);
  blob.resize(blob.size() / 2);
  writeWholeFile(dz, blob);

  const std::string& lastWord = plainEntries.back().word;
  std::string definition;
  std::string headword;
  Dictionary::LookupResult result = Dictionary::LookupResult::Found;
  EXPECT_FALSE(dict.lookup(lastWord.c_str(), definition, headword, &result));
  EXPECT_TRUE(result == Dictionary::LookupResult::ReadError || result == Dictionary::LookupResult::Decompress)
      << "unexpected result " << static_cast<int>(result);
}

// --- dictzip in a lent arena --------------------------------------------------
//
// The word screen lends a lookup the secondary framebuffer, so that a .dict.dz inflates there instead of taking its
// 32 KB window and working state from a heap that may not hold them both. A buffer the size of the X4's framebuffer,
// the smaller panel's, stands in for the lent block.

constexpr size_t kLentFramebufferBytes = 48000;

std::string zippedDictPath(const std::string& folder) {
  return (kDictRoot / folder / "zipped.dict.dz").generic_string();
}

// The operator-new blocks `fn` takes, as the binary's replacement allocator counts them (AllocationRefusal.cpp).
template <typename Fn>
size_t heapBlocksTakenBy(Fn&& fn) {
  const size_t before = heapAllocations();
  fn();
  return heapAllocations() - before;
}

std::string extractToString(const std::string& path, const uint32_t offset, const uint32_t size,
                            DictZip::Scratch& scratch) {
  std::string out(size, '\0');
  if (!DictZip::extractEntry(path.c_str(), offset, size, reinterpret_cast<uint8_t*>(&out[0]), scratch))
    return "<failed>";
  return out;
}

TEST_F(DictionaryTest, DictZipScratchInALentArenaInflatesTheSameBytes) {
  const std::string path = zippedDictPath(provision("zipped", "ZippedArena"));
  std::vector<uint8_t> lent(kLentFramebufferBytes);
  BuildArena arena(lent.data(), lent.size());
  DictZip::Scratch scratch;
  DictZip::ExtractError error = DictZip::ExtractError::Decompress;
  ASSERT_TRUE(scratch.ensure(arena, path.c_str(), &error));
  EXPECT_EQ(error, DictZip::ExtractError::None);
  EXPECT_TRUE(scratch.ready());
  // The window alone is 32 KB; the working state, the chunk table and its path are taken above it.
  EXPECT_GT(arena.used(), InflateReader::ringSizeFor(0));

  // As CompressedDictionaryMatchesThePlainOneByteForByte: chunk starts, middles and boundaries, then a definition
  // across several chunks.
  std::vector<IndexEntry> probes;
  for (size_t i = 0; i < plainEntries.size(); i += 29) probes.push_back(plainEntries[i]);
  const auto longword =
      std::find_if(plainEntries.begin(), plainEntries.end(), [](const IndexEntry& e) { return e.word == "longword"; });
  ASSERT_NE(longword, plainEntries.end());
  ASSERT_GT(longword->size, 4096u * 3);
  probes.push_back(*longword);
  for (const IndexEntry& entry : probes) {
    EXPECT_EQ(extractToString(path, entry.offset, entry.size, scratch), plainDictBlob.substr(entry.offset, entry.size))
        << entry.word;
  }

  scratch.release();
  EXPECT_FALSE(scratch.ready());
  EXPECT_EQ(arena.used(), 0u);
  EXPECT_EQ(arena.releaseFailures(), 0u);
}

TEST_F(DictionaryTest, DictZipScratchRefusesAnArenaTooSmallAndLeavesItUntouched) {
  const std::string path = zippedDictPath(provision("zipped", "ZippedArenaSmall"));
  const IndexEntry& entry = plainEntries[plainEntries.size() / 2];
  const std::string expected = plainDictBlob.substr(entry.offset, entry.size);

  // Grown a few bytes at a time from just under the window's size: each arena short of the window, the working
  // state, the chunk table or its path is refused with nothing left taken in it, and the first to hold them all
  // serves the extraction.
  std::vector<uint8_t> lent(kLentFramebufferBytes);
  bool bound = false;
  for (size_t capacity = InflateReader::ringSizeFor(0) - 4; capacity <= lent.size() && !bound; capacity += 4) {
    BuildArena arena(lent.data(), capacity);
    DictZip::Scratch scratch;
    DictZip::ExtractError error = DictZip::ExtractError::None;
    bound = scratch.ensure(arena, path.c_str(), &error);
    if (!bound) {
      ASSERT_EQ(error, DictZip::ExtractError::LowMemory) << capacity;
      ASSERT_FALSE(scratch.ready()) << capacity;
      ASSERT_EQ(arena.used(), 0u) << capacity;
      ASSERT_EQ(arena.releaseFailures(), 0u) << capacity;
      continue;
    }
    EXPECT_EQ(extractToString(path, entry.offset, entry.size, scratch), expected) << capacity;
    scratch.release();
    EXPECT_EQ(arena.used(), 0u) << capacity;
  }
  ASSERT_TRUE(bound);

  // What a caller does with the refusal: the same scratch on the heap.
  BuildArena tooSmall(lent.data(), 16 * 1024);
  DictZip::Scratch scratch;
  ASSERT_FALSE(scratch.ensure(tooSmall, path.c_str()));
  ASSERT_TRUE(scratch.ensure());
  EXPECT_EQ(extractToString(path, entry.offset, entry.size, scratch), expected);
}

TEST_F(DictionaryTest, DictZipScratchInALentArenaTakesNothingFromTheHeap) {
  const std::string path = zippedDictPath(provision("zipped", "ZippedArenaNoHeap"));
  const IndexEntry& entry = plainEntries[plainEntries.size() / 3];
  std::string out(entry.size, '\0');
  std::vector<uint8_t> lent(kLentFramebufferBytes);
  BuildArena arena(lent.data(), lent.size());
  // What opening the file costs the heap by itself on the host, whose file open copies the path into a std::string.
  // The scratch must add nothing to it.
  const size_t perOpen = heapBlocksTakenBy([&] {
    HalFile file;
    Storage.openFileForRead("TEST", path.c_str(), file);
  });

  DictZip::Scratch scratch;
  bool bound = false;
  bool extracted = false;
  const size_t liveBefore = heapLiveBytes();
  const size_t bindBlocks = heapBlocksTakenBy([&] { bound = scratch.ensure(arena, path.c_str()); });
  const size_t extractBlocks = heapBlocksTakenBy([&] {
    extracted =
        DictZip::extractEntry(path.c_str(), entry.offset, entry.size, reinterpret_cast<uint8_t*>(&out[0]), scratch);
  });
  const size_t releaseBlocks = heapBlocksTakenBy([&] { scratch.release(); });
  const size_t liveAfter = heapLiveBytes();

  EXPECT_TRUE(bound);
  EXPECT_TRUE(extracted);
  EXPECT_EQ(out, plainDictBlob.substr(entry.offset, entry.size));
  EXPECT_EQ(bindBlocks, perOpen);
  EXPECT_EQ(extractBlocks, perOpen);
  EXPECT_EQ(releaseBlocks, 0u);
  EXPECT_EQ(liveAfter, liveBefore);
  EXPECT_EQ(arena.used(), 0u);

  // The count does see a scratch: on the heap it is the window and the state.
  DictZip::Scratch onHeap;
  bool heapReady = false;
  EXPECT_EQ(heapBlocksTakenBy([&] { heapReady = onHeap.ensure(); }), 2u);
  EXPECT_TRUE(heapReady);
}

TEST_F(DictionaryTest, LookupsInflateInALentArenaAndGiveItBackWhole) {
  Dictionary dict;
  ASSERT_NO_FATAL_FAILURE(openIndexed(dict, provision("zipped", "ZippedLent")));
  ASSERT_TRUE(dict.isCompressed());
  // A first lookup takes the session's scan buffers, which stay; the window it took on the heap does not.
  std::string definition;
  std::string headword;
  ASSERT_TRUE(dict.lookup("quixotic", definition, headword));

  std::vector<uint8_t> lent(kLentFramebufferBytes);
  BuildArena arena(lent.data(), lent.size());
  ASSERT_TRUE(dict.useInflateArena(&arena));
  EXPECT_GT(arena.used(), InflateReader::ringSizeFor(0));

  // No heap block of 1 KB or more, which the window or the working state would be. The definitions themselves are
  // still heap strings, so only the short ones are read under the refusal.
  std::vector<const IndexEntry*> shortEntries;
  for (size_t i = 0; i < plainEntries.size(); i += 29) {
    if (plainEntries[i].size < 512) shortEntries.push_back(&plainEntries[i]);
  }
  ASSERT_GT(shortEntries.size(), 10u);
  std::vector<std::string> definitions(shortEntries.size());
  std::vector<char> found(shortEntries.size(), 0);
  {
    const AllocationRefusal refuse(1024);
    for (size_t i = 0; i < shortEntries.size(); i++) {
      std::string matched;
      found[i] = dict.lookup(shortEntries[i]->word.c_str(), definitions[i], matched) ? 1 : 0;
    }
  }
  for (size_t i = 0; i < shortEntries.size(); i++) {
    const IndexEntry& entry = *shortEntries[i];
    EXPECT_TRUE(found[i]) << entry.word;
    EXPECT_EQ(definitions[i], plainDictBlob.substr(entry.offset, entry.size)) << entry.word;
  }
  // A definition across several chunks, and the CJK screen's read (readPrefixDefinitions), in the same lend.
  ASSERT_TRUE(dict.lookup("longword", definition, headword));
  EXPECT_EQ(definition, expectedDefinition("longword"));
  DictPrefixMatch match;
  ASSERT_TRUE(dict.resolvePrefixes("longword", match));
  ASSERT_TRUE(dict.readPrefixDefinitions(match, definition));
  EXPECT_EQ(definition.rfind("longword\n" + expectedDefinition("longword"), 0), 0u);

  dict.useInflateArena(nullptr);
  EXPECT_EQ(arena.used(), 0u);
  EXPECT_EQ(arena.releaseFailures(), 0u);
  // Back on the heap.
  ASSERT_TRUE(dict.lookup("quixotic", definition, headword));
  EXPECT_EQ(definition, expectedDefinition("quixotic"));
}

TEST_F(DictionaryTest, APlainDictionaryOrAnArenaTooSmallLeavesTheLookupOnTheHeap) {
  std::vector<uint8_t> lent(kLentFramebufferBytes);

  Dictionary plain;
  ASSERT_NO_FATAL_FAILURE(openIndexed(plain, provision("plain", "PlainNotLent")));
  EXPECT_FALSE(plain.isCompressed());
  BuildArena plainArena(lent.data(), lent.size());
  EXPECT_FALSE(plain.useInflateArena(&plainArena));
  EXPECT_EQ(plainArena.used(), 0u);

  Dictionary zipped;
  ASSERT_NO_FATAL_FAILURE(openIndexed(zipped, provision("zipped", "ZippedNotLent")));
  BuildArena tooSmall(lent.data(), 16 * 1024);
  EXPECT_FALSE(zipped.useInflateArena(&tooSmall));
  EXPECT_EQ(tooSmall.used(), 0u);

  for (Dictionary* dict : {&plain, &zipped}) {
    std::string definition;
    std::string headword;
    ASSERT_TRUE(dict->lookup("quixotic", definition, headword));
    EXPECT_EQ(definition, expectedDefinition("quixotic"));
  }
  EXPECT_EQ(plainArena.used(), 0u);
  EXPECT_EQ(tooSmall.used(), 0u);
}

// --- index scanning edge cases ---------------------------------------------

TEST_F(DictionaryTest, OverlongHeadwordDoesNotDesynchroniseTheScan) {
  // A headword longer than the reader's word buffer is truncated, but the entry
  // after it must still be found: the scan has to skip the rest of the word and
  // its 8 suffix bytes exactly.
  const std::string giant(600, 'm');
  const std::string tail = "zebra";
  const std::string body = "the striped one";

  std::string idx;
  const auto appendEntry = [&idx](const std::string& word, uint32_t offset, uint32_t size) {
    idx += word;
    idx += '\0';
    const uint8_t suffix[8] = {static_cast<uint8_t>(offset >> 24), static_cast<uint8_t>(offset >> 16),
                               static_cast<uint8_t>(offset >> 8),  static_cast<uint8_t>(offset),
                               static_cast<uint8_t>(size >> 24),   static_cast<uint8_t>(size >> 16),
                               static_cast<uint8_t>(size >> 8),    static_cast<uint8_t>(size)};
    idx.append(reinterpret_cast<const char*>(suffix), sizeof(suffix));
  };
  appendEntry(giant, 0, 5);
  appendEntry(tail, 5, static_cast<uint32_t>(body.size()));

  fs::remove_all(kDictRoot / "Overlong");
  writeWholeFile(kDictRoot / "Overlong" / "big.idx", idx);
  writeWholeFile(kDictRoot / "Overlong" / "big.dict", "GIANT" + body);
  writeWholeFile(kDictRoot / "Overlong" / "big.ifo", "StarDict's dict ifo file\nsametypesequence=m\n");

  Dictionary dict;
  ASSERT_NO_FATAL_FAILURE(openIndexed(dict, "Overlong"));

  std::string definition;
  std::string headword;
  ASSERT_TRUE(dict.lookup(tail.c_str(), definition, headword));
  EXPECT_EQ(headword, tail);
  EXPECT_EQ(definition, body);
}

// --- cleanWord --------------------------------------------------------------

TEST_F(DictionaryTest, CleanWordStripsPunctuationAndFoldsCase) {
  EXPECT_EQ(Dictionary::cleanWord("Garage"), "garage");
  EXPECT_EQ(Dictionary::cleanWord("\"quoted,\""), "quoted");
  EXPECT_EQ(Dictionary::cleanWord("(parens)"), "parens");
  // Curly quotes and dashes are >= 0x80, so they survive the ASCII punctuation
  // test and have to be stripped as whole codepoints.
  EXPECT_EQ(Dictionary::cleanWord("garage."
                                  "\xE2\x80\x9D"),
            "garage");
  EXPECT_EQ(Dictionary::cleanWord("\xE2\x80\x9C"
                                  "garage"
                                  "\xE2\x80\x9D"),
            "garage");
  EXPECT_EQ(Dictionary::cleanWord("\xE2\x80\x94"
                                  "dash"),
            "dash");
  // Accented letters are word bytes and must be preserved untouched.
  EXPECT_EQ(Dictionary::cleanWord("Caf"
                                  "\xC3\xA9"
                                  ","),
            "caf"
            "\xC3\xA9");
  EXPECT_EQ(Dictionary::cleanWord("...."), "");
  EXPECT_EQ(Dictionary::cleanWord(""), "");
  EXPECT_EQ(Dictionary::cleanWord(nullptr), "");
}

TEST_F(DictionaryTest, CleanWordStripsNonAsciiPunctuation) {
  // Outside General Punctuation, every byte >= 0x80 used to count as a letter.
  EXPECT_EQ(Dictionary::cleanWord("«Über»"), "Über");  // non-ASCII case is resolve()'s job
  EXPECT_EQ(Dictionary::cleanWord("« mot »"), "mot");
  EXPECT_EQ(Dictionary::cleanWord("¿Qué?"), "qué");
  EXPECT_EQ(Dictionary::cleanWord("¡Hola!"), "hola");
  EXPECT_EQ(Dictionary::cleanWord("„Wort“"), "wort");
  EXPECT_EQ(Dictionary::cleanWord("‹word›"), "word");
  EXPECT_EQ(Dictionary::cleanWord("word¹"), "word");
  EXPECT_EQ(Dictionary::cleanWord("\xC2\xA0word\xC2\xA0"), "word");  // no-break spaces
  EXPECT_EQ(Dictionary::cleanWord("\xEF\xBB\xBFword"), "word");      // zero-width no-break space
  EXPECT_EQ(Dictionary::cleanWord("（привет），"), "привет");
  EXPECT_EQ(Dictionary::cleanWord("「言葉」。"), "言葉");
  EXPECT_EQ(Dictionary::cleanWord("《书》"), "书");
  EXPECT_EQ(Dictionary::cleanWord("«»"), "");

  // Letters among those code blocks, and marks inside a word, stay.
  EXPECT_EQ(Dictionary::cleanWord("nº"), "nº");
  EXPECT_EQ(Dictionary::cleanWord("µm"), "µm");
  EXPECT_EQ(Dictionary::cleanWord("rock’n’roll"), "rock’n’roll");
  EXPECT_EQ(Dictionary::cleanWord("々"), "々");  // ideographic iteration mark
}

TEST_F(DictionaryTest, GuillemetsDoNotHideAWord) {
  ASSERT_NO_FATAL_FAILURE(writeDictionary("Guillemets", {{"über", "over"}, {"qué", "what"}}));
  Dictionary dict;
  ASSERT_NO_FATAL_FAILURE(openIndexed(dict, "Guillemets"));
  expectHit(dict, "«Über»", "über", "over");
  expectHit(dict, "¿Qué?", "qué", "what");
}

// --- prefix search (runs of CJK text) ----------------------------------------

using HitList = std::vector<std::pair<std::string, int>>;

// Each hit's headword and the run bytes it covers, longest first.
HitList hitsOf(const DictPrefixMatch& match) {
  HitList hits;
  for (uint8_t i = 0; i < match.count; i++) hits.emplace_back(match.hits[i].headword, match.hits[i].runBytes);
  return hits;
}

std::string cp(uint32_t codepoint) {
  std::string out;
  utf8AppendCodepoint(out, codepoint);
  return out;
}

// The one entry `location` names, whatever else its word has.
std::string definitionAt(Dictionary& dict, const DictLocation& location) {
  DictEntries one;
  one.location = location;
  std::string definition;
  EXPECT_TRUE(dict.readResolved(one, definition));
  return definition;
}

bool abortAlways() { return true; }

const std::vector<HeadwordSpec> kBasic = {{"大", "big"},   {"大学", "university"}, {"大学生", "student"},
                                          {"学", "study"}, {"学生", "pupil"},      {"生活", "life"}};

// `count` ASCII headwords "a000", "a001", ...: they sort before every CJK headword, so they push
// the ones after them across the sidecar's 256-entry sample boundary.
std::vector<HeadwordSpec> asciiFillers(int count) {
  std::vector<HeadwordSpec> headwords;
  for (int i = 0; i < count; i++) {
    char word[16];
    snprintf(word, sizeof(word), "a%03d", i);
    headwords.push_back({word, "filler"});
  }
  return headwords;
}

// `leading` fillers, 大 and 大学, then `trailing` headwords 大学 + one more ideograph: with them, the
// descent for 大学生活 lands in a window past both matches.
std::vector<HeadwordSpec> windowLayout(int leading, int trailing) {
  std::vector<HeadwordSpec> headwords = asciiFillers(leading);
  headwords.push_back({"大", "big"});
  headwords.push_back({"大学", "university"});
  for (int i = 0; i < trailing; i++) headwords.push_back({"大学" + cp(0x4E00 + i), "filler"});
  return headwords;
}

TEST_F(DictionaryTest, PrefixSearchFindsTheLongestHeadwordAndTwoShorter) {
  ASSERT_NO_FATAL_FAILURE(writeDictionary("PrefixBasic", kBasic));
  Dictionary dict;
  ASSERT_NO_FATAL_FAILURE(openIndexed(dict, "PrefixBasic"));

  DictPrefixMatch m;
  Dictionary::LookupResult r = Dictionary::LookupResult::NotFound;
  ASSERT_TRUE(dict.resolvePrefixes("大学生活", m, &r));
  EXPECT_EQ(r, Dictionary::LookupResult::Found);
  EXPECT_EQ(hitsOf(m), (HitList{{"大学生", 9}, {"大学", 6}, {"大", 3}}));
  EXPECT_EQ(definitionAt(dict, m.hits[0].location), "student");
  EXPECT_EQ(m.probes, 1);
  EXPECT_GT(m.reads, 0);
  EXPECT_FALSE(m.aborted);
}

TEST_F(DictionaryTest, PrefixSearchKeepsTheThreeLongest) {
  ASSERT_NO_FATAL_FAILURE(writeDictionary(
      "PrefixThree", {{"大", "big"}, {"大学", "university"}, {"大学生", "student"}, {"大学生活", "student life"}}));
  Dictionary dict;
  ASSERT_NO_FATAL_FAILURE(openIndexed(dict, "PrefixThree"));

  DictPrefixMatch m;
  ASSERT_TRUE(dict.resolvePrefixes("大学生活动", m));
  EXPECT_EQ(hitsOf(m), (HitList{{"大学生活", 12}, {"大学生", 9}, {"大学", 6}}));
}

TEST_F(DictionaryTest, PrefixSearchMissesWhenNoHeadwordStartsTheRun) {
  ASSERT_NO_FATAL_FAILURE(writeDictionary("PrefixMiss", kBasic));
  Dictionary dict;
  ASSERT_NO_FATAL_FAILURE(openIndexed(dict, "PrefixMiss"));

  for (const char* run : {"龘龘", ""}) {
    DictPrefixMatch m;
    Dictionary::LookupResult r = Dictionary::LookupResult::Found;
    EXPECT_FALSE(dict.resolvePrefixes(run, m, &r)) << run;
    EXPECT_EQ(r, Dictionary::LookupResult::NotFound) << run;
    EXPECT_EQ(m.count, 0) << run;
    EXPECT_FALSE(m.aborted) << run;
  }
}

// The sidecar samples every 256th entry: 大 and 大学 sit before, at and after a sample, and with the
// trailing entries the first descent lands in a window that holds neither.
TEST_F(DictionaryTest, PrefixSearchFindsMatchesBeforeTheWindow) {
  for (const int leading : {254, 255, 256}) {
    for (const int trailing : {0, 300}) {
      const std::string folder = "PrefixBefore" + std::to_string(leading) + "_" + std::to_string(trailing);
      ASSERT_NO_FATAL_FAILURE(writeDictionary(folder, windowLayout(leading, trailing)));
      Dictionary dict;
      ASSERT_NO_FATAL_FAILURE(openIndexed(dict, folder));

      DictPrefixMatch m;
      ASSERT_TRUE(dict.resolvePrefixes("大学生活", m)) << folder;
      EXPECT_EQ(hitsOf(m), (HitList{{"大学", 6}, {"大", 3}})) << folder;
      EXPECT_EQ(definitionAt(dict, m.hits[0].location), "university") << folder;
    }
  }
}

// Each stem's 300 entries fill more than one window and none of them is a prefix of the run, so
// each probe lands one layer lower; a cap before the first hit would call this run absent.
TEST_F(DictionaryTest, PrefixSearchKeepsDescendingUntilItFindsTheLongestMatch) {
  std::vector<HeadwordSpec> headwords = {{"大", "big"}};
  for (const char* stem : {"大", "大学", "大学生", "大学生活"}) {
    for (int i = 0; i < 300; i++) headwords.push_back({stem + cp(0x4E00 + i), "filler"});
  }
  ASSERT_NO_FATAL_FAILURE(writeDictionary("PrefixLayers", headwords));
  Dictionary dict;
  ASSERT_NO_FATAL_FAILURE(openIndexed(dict, "PrefixLayers"));

  DictPrefixMatch m;
  ASSERT_TRUE(dict.resolvePrefixes("大学生活动", m));
  EXPECT_EQ(hitsOf(m), (HitList{{"大", 3}}));
  EXPECT_EQ(m.probes, 5);
}

TEST_F(DictionaryTest, PrefixSearchRespectsCodepointBoundaries) {
  // The second headword is 大 plus the first byte of 学: a byte prefix of 大学 that ends inside 学.
  ASSERT_NO_FATAL_FAILURE(
      writeDictionary("PrefixBoundary", {{"大", "big"}, {std::string("大") + '\xE5', "a cut-off codepoint"}}));
  Dictionary dict;
  ASSERT_NO_FATAL_FAILURE(openIndexed(dict, "PrefixBoundary"));

  DictPrefixMatch m;
  ASSERT_TRUE(dict.resolvePrefixes("大学", m));
  EXPECT_EQ(hitsOf(m), (HitList{{"大", 3}}));
}

TEST_F(DictionaryTest, PrefixSearchFindsTheOtherScriptThroughTheSynonyms) {
  ASSERT_NO_FATAL_FAILURE(
      writeDictionary("PrefixSynonym", {{"大", "big"}, {"大学", "university"}}, {{"大學", "大学"}}));
  Dictionary dict;
  ASSERT_NO_FATAL_FAILURE(openIndexed(dict, "PrefixSynonym"));

  DictPrefixMatch m;
  ASSERT_TRUE(dict.resolvePrefixes("大學生", m));
  EXPECT_EQ(hitsOf(m), (HitList{{"大学", 6}, {"大", 3}}));
  EXPECT_EQ(definitionAt(dict, m.hits[0].location), "university");
}

TEST_F(DictionaryTest, PrefixSearchPrefersTheIndexOnATie) {
  ASSERT_NO_FATAL_FAILURE(
      writeDictionary("PrefixTie", {{"大学", "university"}, {"学校", "school"}}, {{"大学", "学校"}}));
  Dictionary dict;
  ASSERT_NO_FATAL_FAILURE(openIndexed(dict, "PrefixTie"));

  DictPrefixMatch m;
  ASSERT_TRUE(dict.resolvePrefixes("大学生", m));
  EXPECT_EQ(hitsOf(m), (HitList{{"大学", 6}}));
  EXPECT_EQ(definitionAt(dict, m.hits[0].location), "university");
}

TEST_F(DictionaryTest, PrefixSearchListsEachDefinitionOnce) {
  ASSERT_NO_FATAL_FAILURE(writeDictionary("PrefixOnce", {{"大学", "university"}}, {{"大学生", "大学"}}));
  Dictionary dict;
  ASSERT_NO_FATAL_FAILURE(openIndexed(dict, "PrefixOnce"));

  // The .syn hit covers 9 bytes and the .idx hit 6, both with the one entry: the longer keeps it.
  DictPrefixMatch m;
  ASSERT_TRUE(dict.resolvePrefixes("大学生活", m));
  EXPECT_EQ(hitsOf(m), (HitList{{"大学", 9}}));
}

TEST_F(DictionaryTest, PrefixSearchCountsEveryEntryOfADuplicateHeadword) {
  ASSERT_NO_FATAL_FAILURE(
      writeDictionary("PrefixDuplicates", {{"行", "xing: to walk"}, {"行", "hang: a row"}, {"行人", "pedestrian"}}));
  Dictionary dict;
  ASSERT_NO_FATAL_FAILURE(openIndexed(dict, "PrefixDuplicates"));

  DictPrefixMatch m;
  ASSERT_TRUE(dict.resolvePrefixes("行人们", m));
  EXPECT_EQ(hitsOf(m), (HitList{{"行人", 6}, {"行", 3}}));
  EXPECT_EQ(m.hits[0].entryCount, 1);
  EXPECT_EQ(m.hits[1].entryCount, 2);
  EXPECT_EQ(definitionAt(dict, m.hits[1].location), "xing: to walk");  // the first in .idx order

  ASSERT_TRUE(dict.resolvePrefixes("行了", m));
  EXPECT_EQ(hitsOf(m), (HitList{{"行", 3}}));
  EXPECT_EQ(m.hits[0].entryCount, 2);
}

// At 255 fillers the sample at entry 256 lands on the second 行, so its run starts in the window
// before the one the descent lands in.
TEST_F(DictionaryTest, PrefixSearchFindsADuplicateRunAcrossASample) {
  for (const int leading : {254, 255, 256}) {
    std::vector<HeadwordSpec> headwords = asciiFillers(leading);
    headwords.push_back({"行", "xing: to walk"});
    headwords.push_back({"行", "hang: a row"});
    const std::string folder = "PrefixRunAcross" + std::to_string(leading);
    ASSERT_NO_FATAL_FAILURE(writeDictionary(folder, headwords));
    Dictionary dict;
    ASSERT_NO_FATAL_FAILURE(openIndexed(dict, folder));

    DictPrefixMatch m;
    ASSERT_TRUE(dict.resolvePrefixes("行了", m)) << leading;
    EXPECT_EQ(hitsOf(m), (HitList{{"行", 3}})) << leading;
    EXPECT_EQ(m.hits[0].entryCount, 2) << leading;
    EXPECT_EQ(definitionAt(dict, m.hits[0].location), "xing: to walk") << leading;
  }
}

TEST_F(DictionaryTest, PrefixSearchListsTheWholeRunBehindASynonym) {
  // The synonym points at the SECOND 银行; the run is still listed from its first entry.
  ASSERT_NO_FATAL_FAILURE(writeDictionary("PrefixSynonymRun",
                                          {{"银", "silver"}, {"银行", "bank"}, {"银行", "row of silver shops"}},
                                          {{"銀行", "银行", /*occurrence=*/1}}));
  Dictionary dict;
  ASSERT_NO_FATAL_FAILURE(openIndexed(dict, "PrefixSynonymRun"));

  DictPrefixMatch m;
  ASSERT_TRUE(dict.resolvePrefixes("銀行家", m));
  EXPECT_EQ(hitsOf(m), (HitList{{"银行", 6}}));
  EXPECT_EQ(m.hits[0].entryCount, 2);
  EXPECT_EQ(definitionAt(dict, m.hits[0].location), "bank");
}

// Ten entries of 行: the scan counts at most eight, and so does locateRun. At 250 fillers the sample
// at entry 256 lands on the seventh 行, so the run is counted again from its first entry.
TEST_F(DictionaryTest, PrefixSearchListsAtMostEightEntriesOfAHeadword) {
  for (const int leading : {0, 250}) {
    std::vector<HeadwordSpec> headwords = asciiFillers(leading);
    for (int i = 0; i < 10; i++) headwords.push_back({"行", "xing " + std::to_string(i)});
    const std::string folder = "PrefixEightEntries" + std::to_string(leading);
    ASSERT_NO_FATAL_FAILURE(writeDictionary(folder, headwords));
    Dictionary dict;
    ASSERT_NO_FATAL_FAILURE(openIndexed(dict, folder));

    DictPrefixMatch m;
    ASSERT_TRUE(dict.resolvePrefixes("行了", m)) << leading;
    EXPECT_EQ(hitsOf(m), (HitList{{"行", 3}})) << leading;
    EXPECT_EQ(m.hits[0].entryCount, 8) << leading;  // DictPrefixMatch::MAX_ENTRIES_PER_HIT
    EXPECT_EQ(definitionAt(dict, m.hits[0].location), "xing 0") << leading;
  }
}

// The .idx keeps its three longest; a longer .syn hit takes a place and the shortest falls off,
// and a .syn hit shorter than all three is not even followed (no probe).
TEST_F(DictionaryTest, PrefixSearchMergesALongerSynonymIntoAFullList) {
  ASSERT_NO_FATAL_FAILURE(writeDictionary("PrefixFullMerge",
                                          {{"大", "big"},
                                           {"大学", "university"},
                                           {"大学生", "student"},
                                           {"大学生活", "student life"},
                                           {"活动", "activity"}},
                                          {{"大学生活动", "活动"}, {"大", "活动"}}));
  Dictionary dict;
  ASSERT_NO_FATAL_FAILURE(openIndexed(dict, "PrefixFullMerge"));

  DictPrefixMatch m;
  ASSERT_TRUE(dict.resolvePrefixes("大学生活动", m));
  EXPECT_EQ(hitsOf(m), (HitList{{"活动", 15}, {"大学生活", 12}, {"大学生", 9}}));
  EXPECT_EQ(definitionAt(dict, m.hits[0].location), "activity");
  EXPECT_EQ(m.probes, 3);  // the .idx scan, the .syn scan, and following 大学生活动 only
}

// The search takes a run's first MAX_PREFIX_RUN_BYTES (48), cut back to a codepoint boundary.
TEST_F(DictionaryTest, PrefixSearchSearchesTheFirstFortyEightBytesOfALongerRun) {
  const auto repeat = [](const std::string& s, int n) {
    std::string out;
    for (int i = 0; i < n; i++) out += s;
    return out;
  };
  const std::string sixteen = repeat("中", 16);  // 48 bytes
  const std::string aFifteen = "a" + repeat("中", 15);
  ASSERT_NO_FATAL_FAILURE(writeDictionary("PrefixLongRun", {{sixteen, "sixteen"},
                                                            {sixteen + "中", "seventeen"},
                                                            {aFifteen, "a and fifteen"},
                                                            {"a" + sixteen, "a and sixteen"}}));
  Dictionary dict;
  ASSERT_NO_FATAL_FAILURE(openIndexed(dict, "PrefixLongRun"));

  DictPrefixMatch m;
  ASSERT_TRUE(dict.resolvePrefixes((sixteen + "中").c_str(), m));
  EXPECT_EQ(hitsOf(m), (HitList{{sixteen, 48}}));

  // Byte 48 of this run falls inside its sixteenth 中, so the search takes 46 bytes.
  ASSERT_TRUE(dict.resolvePrefixes(("a" + sixteen).c_str(), m));
  EXPECT_EQ(hitsOf(m), (HitList{{aFifteen, 46}}));
}

TEST_F(DictionaryTest, PrefixSearchOnHangulFindsTheNounBeforeItsParticle) {
  ASSERT_NO_FATAL_FAILURE(writeDictionary("PrefixHangul", {{"학", "learning"}, {"학교", "school"}}));
  Dictionary dict;
  ASSERT_NO_FATAL_FAILURE(openIndexed(dict, "PrefixHangul"));

  DictPrefixMatch m;
  ASSERT_TRUE(dict.resolvePrefixes("학교에서", m));
  EXPECT_EQ(hitsOf(m), (HitList{{"학교", 6}, {"학", 3}}));
}

TEST_F(DictionaryTest, PrefixSearchWorksBeforeTheIndexIsBuilt) {
  ASSERT_NO_FATAL_FAILURE(writeDictionary("PrefixUnindexed", kBasic));
  Dictionary dict;
  ASSERT_TRUE(dict.open("PrefixUnindexed"));
  ASSERT_TRUE(dict.needsIndex());

  DictPrefixMatch m;
  ASSERT_TRUE(dict.resolvePrefixes("大学生活", m));
  EXPECT_EQ(hitsOf(m), (HitList{{"大学生", 9}, {"大学", 6}, {"大", 3}}));
}

TEST_F(DictionaryTest, PrefixSearchGivesUpBetweenProbesWhenAsked) {
  // The first probe finds nothing, so a second is due: the check is asked, and says give up.
  ASSERT_NO_FATAL_FAILURE(writeDictionary("PrefixAbortFar", windowLayout(256, 300)));
  Dictionary farDict;
  ASSERT_NO_FATAL_FAILURE(openIndexed(farDict, "PrefixAbortFar"));
  DictPrefixMatch m;
  Dictionary::LookupResult r = Dictionary::LookupResult::Found;
  EXPECT_FALSE(farDict.resolvePrefixes("大学生活", m, &r, &abortAlways));
  EXPECT_TRUE(m.aborted);
  EXPECT_EQ(m.count, 0);
  EXPECT_EQ(m.probes, 1);
  EXPECT_EQ(r, Dictionary::LookupResult::NotFound);

  // One probe answers, so there is no "between".
  ASSERT_NO_FATAL_FAILURE(writeDictionary("PrefixAbortNear", kBasic));
  Dictionary nearDict;
  ASSERT_NO_FATAL_FAILURE(openIndexed(nearDict, "PrefixAbortNear"));
  DictPrefixMatch answered;
  EXPECT_TRUE(nearDict.resolvePrefixes("大学生活", answered, nullptr, &abortAlways));
  EXPECT_FALSE(answered.aborted);
  EXPECT_EQ(answered.count, 3);
}

// A probe reads the window's first headword (w0) from its own scan, not from a window record: the
// record's bounds cost a sample read and two refills (the next sample's headword, then the scan's
// seek back) that the prefix search never uses, since every later target sorts before w0.
TEST_F(DictionaryTest, PrefixSearchTakesTheWindowsFirstHeadwordFromItsScan) {
  // 600 fillers (13 bytes each), 大 大学 大学生, then 300 of 学 + one ideograph: 903 entries, samples
  // at entries 0, 256, 512 and 768 (bytes 0, 3328, 6656, 10320), all in the .qidx's first block.
  // The descent reads that block and refills at samples 2 and 3; the scan refills from byte 6656 up
  // to 学一 at 7845: [6656, 7168), [7168, 7680), [7680, 8192). 1 block and 5 refills.
  std::vector<HeadwordSpec> headwords = asciiFillers(600);
  for (const char* word : {"大", "大学", "大学生"}) headwords.push_back({word, "filler"});
  for (int i = 0; i < 300; i++) headwords.push_back({"学" + cp(0x4E00 + i), "filler"});
  ASSERT_NO_FATAL_FAILURE(writeDictionary("PrefixReadsIdx", headwords));
  Dictionary idxDict;
  ASSERT_NO_FATAL_FAILURE(openIndexed(idxDict, "PrefixReadsIdx"));
  DictPrefixMatch m;
  ASSERT_TRUE(idxDict.resolvePrefixes("大学生活", m));
  EXPECT_EQ(hitsOf(m), (HitList{{"大学生", 9}, {"大学", 6}, {"大", 3}}));
  EXPECT_EQ(m.probes, 1);
  EXPECT_EQ(m.reads, 6);  // 8 with the window record

  // The same over a .syn: 600 fillers (9 bytes each), 大學, then 300 of 學 + one ideograph; samples
  // at bytes 0, 2304, 4608 and 7248. The .idx (one sample, 27 bytes): 1 block and 1 refill. The
  // .syn: 1 block, the descent's 2 refills, the scan's [4608, 5120) and [5120, 5632). Following 大學
  // to 大学: 1 block and 1 refill, since the .idx buffer held .sidx blocks meanwhile.
  std::vector<SynonymSpec> synonyms;
  for (int i = 0; i < 600; i++) {
    char word[16];
    snprintf(word, sizeof(word), "b%03d", i);
    synonyms.push_back({word, "大"});
  }
  synonyms.push_back({"大學", "大学"});
  for (int i = 0; i < 300; i++) synonyms.push_back({"學" + cp(0x4E00 + i), "大"});
  ASSERT_NO_FATAL_FAILURE(writeDictionary("PrefixReadsSyn", {{"大", "big"}, {"大学", "university"}}, synonyms));
  Dictionary synDict;
  ASSERT_NO_FATAL_FAILURE(openIndexed(synDict, "PrefixReadsSyn"));
  ASSERT_TRUE(synDict.resolvePrefixes("大學生", m));
  EXPECT_EQ(hitsOf(m), (HitList{{"大学", 6}, {"大", 3}}));
  EXPECT_EQ(m.probes, 3);  // the .idx scan, the .syn scan, following 大學
  EXPECT_EQ(m.reads, 9);   // 11 with the window record
}

// The .syn descent for 大学生活 lands past 300 synonyms 大 + one ideograph, so its next target would
// be 大. A .syn hit of 大's length could only tie with the .idx hit 大, which wins a tie, so that
// probe is not run; with no .idx hit of that length it is, and finds the synonym.
TEST_F(DictionaryTest, PrefixSearchSkipsASynonymProbeWhoseHitsTheIndexHitsWouldBeat) {
  std::vector<SynonymSpec> synonyms;
  for (int i = 0; i < 300; i++) synonyms.push_back({"大" + cp(0x4E00 + i), "太"});
  synonyms.push_back({"大", "太"});
  ASSERT_NO_FATAL_FAILURE(
      writeDictionary("PrefixSynTied", {{"大", "big"}, {"大学", "university"}, {"太", "too"}}, synonyms));
  Dictionary tied;
  ASSERT_NO_FATAL_FAILURE(openIndexed(tied, "PrefixSynTied"));
  DictPrefixMatch m;
  ASSERT_TRUE(tied.resolvePrefixes("大学生活", m));
  EXPECT_EQ(hitsOf(m), (HitList{{"大学", 6}, {"大", 3}}));
  EXPECT_EQ(m.probes, 2);  // the .idx scan and one .syn scan

  ASSERT_NO_FATAL_FAILURE(writeDictionary("PrefixSynUntied", {{"大学", "university"}, {"太", "too"}}, synonyms));
  Dictionary untied;
  ASSERT_NO_FATAL_FAILURE(openIndexed(untied, "PrefixSynUntied"));
  ASSERT_TRUE(untied.resolvePrefixes("大学生活", m));
  EXPECT_EQ(hitsOf(m), (HitList{{"大学", 6}, {"太", 3}}));
  EXPECT_EQ(m.probes, 4);  // the .idx scan, two .syn scans, following 大 to 太
}

// 40,000 fillers and 大 大学 大学生: 157 samples, 652 bytes of .qidx in two 512-byte blocks. The
// descent for 大学生活 reads samples 78, 117, 137, 147, 152, 154, 155 and 156, then 156 again: two
// block reads instead of nine sample reads.
TEST_F(DictionaryTest, PrefixSearchReadsTheSamplesInBlocks) {
  std::vector<HeadwordSpec> headwords;
  for (int i = 0; i < 40000; i++) {
    char word[16];
    snprintf(word, sizeof(word), "a%05d", i);
    headwords.push_back({word, "f"});
  }
  for (const char* word : {"大", "大学", "大学生"}) headwords.push_back({word, "filler"});
  ASSERT_NO_FATAL_FAILURE(writeDictionary("PrefixSampleBlocks", headwords));
  Dictionary dict;
  ASSERT_NO_FATAL_FAILURE(openIndexed(dict, "PrefixSampleBlocks"));

  DictPrefixMatch m;
  ASSERT_TRUE(dict.resolvePrefixes("大学生活", m));
  EXPECT_EQ(hitsOf(m), (HitList{{"大学生", 9}, {"大学", 6}, {"大", 3}}));
  EXPECT_EQ(m.probes, 1);
  // The 8 descent steps' headword refills, the 2 blocks, and 1 refill for the scan from sample 156
  // (byte 599040, which the descent's last refill holds) through the last 1005 bytes.
  EXPECT_EQ(m.reads, 11);  // 18 with a read per sample
}

// 2000 fillers, 大 and 大学 (entries 2000 and 2001), then 300 of 大学 + one ideograph: 9 samples.
// The descent for 大学生活 lands in the last window (sample 8, 大学 + an ideograph), which holds no
// match, so the next target is 大学. It sorts below sample 8, and sample 7 is at or below it: one
// step back finds the window, where a descent from the top took four.
TEST_F(DictionaryTest, PrefixSearchStepsBackToTheWindowBefore) {
  std::vector<HeadwordSpec> headwords = asciiFillers(2000);
  headwords.push_back({"大", "big"});
  headwords.push_back({"大学", "university"});
  for (int i = 0; i < 300; i++) headwords.push_back({"大学" + cp(0x4E00 + i), "filler"});
  ASSERT_NO_FATAL_FAILURE(writeDictionary("PrefixStepBack", headwords));
  Dictionary dict;
  ASSERT_NO_FATAL_FAILURE(openIndexed(dict, "PrefixStepBack"));

  DictPrefixMatch m;
  ASSERT_TRUE(dict.resolvePrefixes("大学生活", m));
  EXPECT_EQ(hitsOf(m), (HitList{{"大学", 6}, {"大", 3}}));
  EXPECT_EQ(m.probes, 2);
  EXPECT_EQ(m.reads, 19);  // 23 with a second descent from the top
}

// A followed synonym finds its run in the window its entry lies in: 600 fillers (13 bytes each), 银,
// then two 银行 at entries 601 and 602, samples at bytes 0, 3328 and 6656. The .idx probe of 銀行家:
// 1 block and 4 refills (银 sorts after 銀, so the scan stops there); the .syn: 1 and 1. Following
// 銀行 to entry 602: 1 block and the 3 refills from byte 6656; the run's first entry (601) is in the
// buffer, so no second descent looks for it.
TEST_F(DictionaryTest, PrefixSearchFollowsASynonymWithinItsWindow) {
  std::vector<HeadwordSpec> headwords = asciiFillers(600);
  headwords.push_back({"银", "silver"});
  headwords.push_back({"银行", "bank"});
  headwords.push_back({"银行", "row of silver shops"});
  ASSERT_NO_FATAL_FAILURE(writeDictionary("PrefixFollowWindow", headwords, {{"銀行", "银行", /*occurrence=*/1}}));
  Dictionary dict;
  ASSERT_NO_FATAL_FAILURE(openIndexed(dict, "PrefixFollowWindow"));

  DictPrefixMatch m;
  ASSERT_TRUE(dict.resolvePrefixes("銀行家", m));
  EXPECT_EQ(hitsOf(m), (HitList{{"银行", 6}}));
  EXPECT_EQ(m.hits[0].entryCount, 2);
  EXPECT_EQ(definitionAt(dict, m.hits[0].location), "bank");
  EXPECT_EQ(m.probes, 3);  // the .idx scan, the .syn scan, following 銀行
  EXPECT_EQ(m.reads, 11);  // 15 with the second descent
}

// The synonym names the second 行. At 255 fillers that entry opens the window (sample 256), so the
// run may begin in the window before, and does: the run is still listed from its first entry.
TEST_F(DictionaryTest, PrefixSearchFollowsASynonymWhoseRunCrossesASample) {
  for (const int leading : {254, 255, 256}) {
    std::vector<HeadwordSpec> headwords = asciiFillers(leading);
    headwords.push_back({"行", "xing: to walk"});
    headwords.push_back({"行", "hang: a row"});
    const std::string folder = "PrefixFollowAcross" + std::to_string(leading);
    ASSERT_NO_FATAL_FAILURE(writeDictionary(folder, headwords, {{"衍", "行", /*occurrence=*/1}}));
    Dictionary dict;
    ASSERT_NO_FATAL_FAILURE(openIndexed(dict, folder));

    DictPrefixMatch m;
    ASSERT_TRUE(dict.resolvePrefixes("衍了", m)) << leading;
    EXPECT_EQ(hitsOf(m), (HitList{{"行", 3}})) << leading;
    EXPECT_EQ(m.hits[0].entryCount, 2) << leading;
    EXPECT_EQ(definitionAt(dict, m.hits[0].location), "xing: to walk") << leading;
  }
}

TEST_F(DictionaryTest, LatinDictionaryAnswersACjkRunInOneProbePerFile) {
  const struct {
    const char* fixture;
    int probes;
  } cases[] = {{"zipped", 1}, {"plain", 2}};  // plain carries a .syn, zipped does not
  for (const auto& c : cases) {
    const std::string folder = provision(c.fixture, std::string("PrefixLatin_") + c.fixture);
    Dictionary dict;
    ASSERT_NO_FATAL_FAILURE(openIndexed(dict, folder));

    DictPrefixMatch m;
    Dictionary::LookupResult r = Dictionary::LookupResult::Found;
    EXPECT_FALSE(dict.resolvePrefixes("大学", m, &r)) << c.fixture;
    EXPECT_EQ(r, Dictionary::LookupResult::NotFound) << c.fixture;
    EXPECT_EQ(m.probes, c.probes) << c.fixture;
  }
}

// --- readPrefixDefinitions ----------------------------------------------------

std::string prefixDefinitions(Dictionary& dict, const char* run, Dictionary::LookupResult* r = nullptr) {
  DictPrefixMatch m;
  EXPECT_TRUE(dict.resolvePrefixes(run, m)) << run;
  std::string out;
  EXPECT_TRUE(dict.readPrefixDefinitions(m, out, r)) << run;
  return out;
}

TEST_F(DictionaryTest, PrefixDefinitionsListEachEntryUnderItsHeadword) {
  ASSERT_NO_FATAL_FAILURE(writeDictionary("DefsBasic", kBasic));
  Dictionary dict;
  ASSERT_NO_FATAL_FAILURE(openIndexed(dict, "DefsBasic"));
  Dictionary::LookupResult r = Dictionary::LookupResult::NotFound;
  EXPECT_EQ(prefixDefinitions(dict, "大学生活", &r), "大学生\nstudent\n\n大学\nuniversity\n\n大\nbig");
  EXPECT_EQ(r, Dictionary::LookupResult::Found);
}

TEST_F(DictionaryTest, PrefixDefinitionsListEveryEntryOfTheLongestMatchFirst) {
  ASSERT_NO_FATAL_FAILURE(
      writeDictionary("DefsRun", {{"银", "silver"}, {"银行", "bank"}, {"银行", "row of silver shops"}}));
  Dictionary dict;
  ASSERT_NO_FATAL_FAILURE(openIndexed(dict, "DefsRun"));
  EXPECT_EQ(prefixDefinitions(dict, "银行家"), "银行\nbank\n\n银行\nrow of silver shops\n\n银\nsilver");
}

TEST_F(DictionaryTest, PrefixDefinitionsFillTheBufferBeforeTheShorterMatches) {
  ASSERT_NO_FATAL_FAILURE(writeDictionary(
      "DefsFill", {{"银", "silver"}, {"银行", std::string(32768, 'a')}, {"银行", std::string(32748, 'b')}}));
  Dictionary dict;
  ASSERT_NO_FATAL_FAILURE(openIndexed(dict, "DefsFill"));
  const std::string out = prefixDefinitions(dict, "银行家");
  EXPECT_EQ(out.size(), 65532u);  // 7 + 32768 + 2 + 7 + 32748
  EXPECT_NE(out.find(std::string(32748, 'b')), std::string::npos);
  EXPECT_EQ(out.find("silver"), std::string::npos);  // its 12 bytes do not fit the 4 that are left
}

TEST_F(DictionaryTest, HtmlPrefixDefinitionsBoldTheirEscapedHeadword) {
  ASSERT_NO_FATAL_FAILURE(
      writeDictionary("DefsHtml", {{"大", "<i>big</i>"}, {"大学", "<i>university</i>"}, {"a<b&c", "odd"}}, {}, "h"));
  Dictionary dict;
  ASSERT_NO_FATAL_FAILURE(openIndexed(dict, "DefsHtml"));
  ASSERT_TRUE(dict.definitionsAreHtml());
  EXPECT_EQ(prefixDefinitions(dict, "大学"), "<p><b>大学</b></p><i>university</i><p><b>大</b></p><i>big</i>");
  EXPECT_EQ(prefixDefinitions(dict, "a<b&c"), "<p><b>a&lt;b&amp;c</b></p>odd");
}

TEST_F(DictionaryTest, PrefixDefinitionsStayWithinTheCap) {
  ASSERT_NO_FATAL_FAILURE(
      writeDictionary("DefsCap", {{"大", "big"}, {"大学", std::string(Dictionary::MAX_DEFINITION_BYTES, 'y')}}));
  Dictionary dict;
  ASSERT_NO_FATAL_FAILURE(openIndexed(dict, "DefsCap"));
  const std::string out = prefixDefinitions(dict, "大学");
  EXPECT_EQ(out.size(), Dictionary::MAX_DEFINITION_BYTES);
  EXPECT_EQ(out.rfind("大学\n", 0), 0u);
  EXPECT_EQ(out.find("big"), std::string::npos);
}

TEST_F(DictionaryTest, PrefixDefinitionsFromADictZipMatchThePlainOnes) {
  Dictionary plain;
  Dictionary zipped;
  ASSERT_NO_FATAL_FAILURE(openIndexed(plain, provision("plain", "DefsPlain")));
  ASSERT_NO_FATAL_FAILURE(openIndexed(zipped, provision("zipped", "DefsZipped")));
  for (const std::string run : {"quixotic", "longword"}) {
    const std::string fromPlain = prefixDefinitions(plain, run.c_str());
    EXPECT_EQ(prefixDefinitions(zipped, run.c_str()), fromPlain) << run;
    EXPECT_EQ(fromPlain.rfind(run + "\n" + expectedDefinition(run), 0), 0u) << run;
  }
}

TEST_F(DictionaryTest, PrefixDefinitionsReportLowMemory) {
  ASSERT_NO_FATAL_FAILURE(writeDictionary("DefsLowMem", kBasic));
  Dictionary dict;
  ASSERT_NO_FATAL_FAILURE(openIndexed(dict, "DefsLowMem"));
  DictPrefixMatch m;
  ASSERT_TRUE(dict.resolvePrefixes("大学生活", m));

  const auto savedContig = ESP.getMaxAllocHeap();
  ESP.setMaxAllocHeap(1024);
  std::string out = "stale";
  Dictionary::LookupResult r = Dictionary::LookupResult::Found;
  EXPECT_FALSE(dict.readPrefixDefinitions(m, out, &r));
  ESP.setMaxAllocHeap(savedContig);
  EXPECT_EQ(r, Dictionary::LookupResult::LowMemory);
  EXPECT_TRUE(out.empty());
}

// What the word screen's retry on the lent path relies on (DictionaryWordSelectActivity::performLookup): a read
// refused for low memory keeps the arena bound and nothing in it, and the same read made again into the same string,
// once the font caches have gone, gives exactly the definition: nothing is appended to what the string held.
TEST_F(DictionaryTest, AReadRefusedForLowMemoryInALentArenaReadsWholeOnTheRetry) {
  Dictionary dict;
  ASSERT_NO_FATAL_FAILURE(openIndexed(dict, provision("zipped", "ZippedRetry")));
  std::vector<uint8_t> lent(kLentFramebufferBytes);
  BuildArena arena(lent.data(), lent.size());
  ASSERT_TRUE(dict.useInflateArena(&arena));
  const size_t bound = arena.used();
  DictEntries entries;
  std::string headword;
  ASSERT_TRUE(dict.resolve("longword", entries, headword));
  DictPrefixMatch match;
  ASSERT_TRUE(dict.resolvePrefixes("longword", match));

  std::string viaLookup = "stale";
  std::string viaLocation = "stale";
  std::string viaPrefix = "stale";
  Dictionary::LookupResult lookupResult = Dictionary::LookupResult::Found;
  Dictionary::LookupResult locationResult = Dictionary::LookupResult::Found;
  Dictionary::LookupResult prefixResult = Dictionary::LookupResult::Found;
  const auto savedContig = ESP.getMaxAllocHeap();
  ESP.setMaxAllocHeap(1024);  // no block for the definition text
  const bool lookupFirst = dict.lookup("longword", viaLookup, headword, &lookupResult);
  const bool locationFirst = dict.readResolved(entries, viaLocation, &locationResult);
  const bool prefixFirst = dict.readPrefixDefinitions(match, viaPrefix, &prefixResult);
  ESP.setMaxAllocHeap(savedContig);
  EXPECT_FALSE(lookupFirst);
  EXPECT_FALSE(locationFirst);
  EXPECT_FALSE(prefixFirst);
  EXPECT_EQ(lookupResult, Dictionary::LookupResult::LowMemory);
  EXPECT_EQ(locationResult, Dictionary::LookupResult::LowMemory);
  EXPECT_EQ(prefixResult, Dictionary::LookupResult::LowMemory);
  EXPECT_EQ(arena.used(), bound);

  // The retry: the same calls, into the same strings.
  ASSERT_TRUE(dict.lookup("longword", viaLookup, headword));
  ASSERT_TRUE(dict.readResolved(entries, viaLocation));
  ASSERT_TRUE(dict.readPrefixDefinitions(match, viaPrefix));
  EXPECT_EQ(viaLookup, expectedDefinition("longword"));
  EXPECT_EQ(viaLocation, expectedDefinition("longword"));
  std::string once;
  ASSERT_TRUE(dict.readPrefixDefinitions(match, once));
  EXPECT_EQ(viaPrefix, once);
  EXPECT_EQ(viaPrefix.rfind("longword\n" + expectedDefinition("longword"), 0), 0u);

  dict.useInflateArena(nullptr);
  EXPECT_EQ(arena.used(), 0u);
}

TEST_F(DictionaryTest, PrefixDefinitionsOfATruncatedDictFileFailWithTheOutputCleared) {
  ASSERT_NO_FATAL_FAILURE(writeDictionary("DefsTruncated", kBasic));
  Dictionary dict;
  ASSERT_NO_FATAL_FAILURE(openIndexed(dict, "DefsTruncated"));
  DictPrefixMatch m;
  ASSERT_TRUE(dict.resolvePrefixes("大学生活", m));

  // The card loses the tail of the .dict after the search: the entries are still named by the index.
  const fs::path dictFile = kDictRoot / "DefsTruncated" / "words.dict";
  fs::resize_file(dictFile, 3);

  std::string out = "stale";
  Dictionary::LookupResult r = Dictionary::LookupResult::Found;
  EXPECT_FALSE(dict.readPrefixDefinitions(m, out, &r));
  EXPECT_EQ(r, Dictionary::LookupResult::ReadError);
  EXPECT_TRUE(out.empty());
}

TEST_F(DictionaryTest, PrefixDefinitionsOfNoHitsReadNothing) {
  ASSERT_NO_FATAL_FAILURE(writeDictionary("DefsNone", kBasic));
  Dictionary dict;
  ASSERT_NO_FATAL_FAILURE(openIndexed(dict, "DefsNone"));
  const DictPrefixMatch m;
  std::string out;
  Dictionary::LookupResult r = Dictionary::LookupResult::Found;
  EXPECT_FALSE(dict.readPrefixDefinitions(m, out, &r));
  EXPECT_EQ(r, Dictionary::LookupResult::NotFound);
}

// --- every entry of a word (crosspoint-reader #3980, #4110) -------------------

// resolve() then readResolved(), as the word screen does while the cursor rests on a word.
std::string resolveThenRead(Dictionary& dict, const char* word) {
  DictEntries resolved;
  std::string headword;
  EXPECT_TRUE(dict.resolve(word, resolved, headword)) << word;
  std::string definition;
  EXPECT_TRUE(dict.readResolved(resolved, definition)) << word;
  return definition;
}

std::string lookedUp(Dictionary& dict, const char* word) {
  std::string definition;
  std::string headword;
  EXPECT_TRUE(dict.lookup(word, definition, headword)) << word;
  return definition;
}

const std::vector<HeadwordSpec> kRepeated = {
    {"bank", "the side of a river"}, {"bank", "a house of money"}, {"barn", "a farm building"}};
constexpr char kBothBanks[] = "bank\nthe side of a river\n\nbank\na house of money";

TEST_F(DictionaryTest, ARepeatedHeadwordShowsEveryEntry) {
  ASSERT_NO_FATAL_FAILURE(writeDictionary("Repeated", kRepeated));
  Dictionary dict;
  ASSERT_NO_FATAL_FAILURE(openIndexed(dict, "Repeated"));
  std::string definition;
  std::string headword;
  ASSERT_TRUE(dict.lookup("bank", definition, headword));
  EXPECT_EQ(headword, "bank");
  EXPECT_EQ(definition, kBothBanks);
  EXPECT_EQ(resolveThenRead(dict, "bank"), kBothBanks);
  // A word with one entry is read as it always was: no heading.
  EXPECT_EQ(lookedUp(dict, "barn"), "a farm building");
}

TEST_F(DictionaryTest, ARepeatedHeadwordInAnHtmlDictionaryIsHeadedInBold) {
  ASSERT_NO_FATAL_FAILURE(writeDictionary("RepeatedHtml", kRepeated, {}, "h"));
  Dictionary dict;
  ASSERT_NO_FATAL_FAILURE(openIndexed(dict, "RepeatedHtml"));
  EXPECT_EQ(lookedUp(dict, "bank"), "<p><b>bank</b></p>the side of a river<p><b>bank</b></p>a house of money");
}

TEST_F(DictionaryTest, AStemmedWordShowsEveryEntryOfItsHeadword) {
  ASSERT_NO_FATAL_FAILURE(writeDictionary("RepeatedStem", kRepeated));
  Dictionary dict;
  ASSERT_NO_FATAL_FAILURE(openIndexed(dict, "RepeatedStem"));
  EXPECT_EQ(lookedUp(dict, "banks"), kBothBanks);
}

// "Polish" is not "polish": only the exact-case word's own entries are listed.
TEST_F(DictionaryTest, ARepeatedHeadwordKeepsItsCaseVariantsOut) {
  ASSERT_NO_FATAL_FAILURE(writeDictionary(
      "RepeatedCase",
      {{"POLISH", "an acronym"}, {"Polish", "of Poland"}, {"polish", "to shine"}, {"polish", "a shine"}}));
  Dictionary dict;
  ASSERT_NO_FATAL_FAILURE(openIndexed(dict, "RepeatedCase"));
  EXPECT_EQ(lookedUp(dict, "polish"), "polish\nto shine\n\npolish\na shine");
}

TEST_F(DictionaryTest, ARepeatedHeadwordFoundByItsCapitalisedFormListsThatForm) {
  ASSERT_NO_FATAL_FAILURE(writeDictionary(
      "RepeatedCapital", {{"Paris", "the capital"}, {"Paris", "a Trojan prince"}, {"park", "a garden"}}));
  Dictionary dict;
  ASSERT_NO_FATAL_FAILURE(openIndexed(dict, "RepeatedCapital"));
  EXPECT_EQ(lookedUp(dict, "paris"), "Paris\nthe capital\n\nParis\na Trojan prince");
}

// Sample 1 opens at entry 256. At 254 fillers the run ends just before it, at 255 it straddles it, at 256 it opens it.
TEST_F(DictionaryTest, ARepeatedHeadwordIsListedFromItsFirstEntryAcrossASample) {
  for (const int leading : {254, 255, 256}) {
    std::vector<HeadwordSpec> headwords = asciiFillers(leading);
    headwords.push_back({"zzbank", "first"});
    headwords.push_back({"zzbank", "second"});
    const std::string folder = "RepeatedAcross" + std::to_string(leading);
    ASSERT_NO_FATAL_FAILURE(writeDictionary(folder, headwords));
    Dictionary dict;
    ASSERT_NO_FATAL_FAILURE(openIndexed(dict, folder));
    EXPECT_EQ(lookedUp(dict, "zzbank"), "zzbank\nfirst\n\nzzbank\nsecond") << leading;
  }
}

TEST_F(DictionaryTest, ARepeatedHeadwordListsAtMostEightEntries) {
  std::vector<HeadwordSpec> headwords;
  for (int i = 0; i < 10; i++) headwords.push_back({"bank", "meaning" + std::to_string(i)});
  ASSERT_NO_FATAL_FAILURE(writeDictionary("RepeatedCap", headwords));
  Dictionary dict;
  ASSERT_NO_FATAL_FAILURE(openIndexed(dict, "RepeatedCap"));
  const std::string definition = lookedUp(dict, "bank");
  EXPECT_NE(definition.find("meaning7"), std::string::npos);
  EXPECT_EQ(definition.find("meaning8"), std::string::npos);
}

// What fits today still shows: too little heap for both entries is no reason to show neither.
TEST_F(DictionaryTest, TooLittleHeapForEveryEntryStillShowsTheFirst) {
  const std::string big(9000, 'x');
  ASSERT_NO_FATAL_FAILURE(writeDictionary("RepeatedLowHeap", {{"bank", big + "1"}, {"bank", big + "2"}}));
  Dictionary dict;
  ASSERT_NO_FATAL_FAILURE(openIndexed(dict, "RepeatedLowHeap"));
  const auto saved = ESP.getMaxAllocHeap();
  ESP.setMaxAllocHeap(9001 + 8 * 1024 + 16);  // room for one entry and the headroom, not for two
  std::string definition;
  std::string headword;
  const bool found = dict.lookup("bank", definition, headword);
  ESP.setMaxAllocHeap(saved);
  EXPECT_TRUE(found);
  EXPECT_EQ(definition, big + "1");
}

TEST_F(DictionaryTest, ASynonymOfSeveralHeadwordsShowsThemAll) {
  ASSERT_NO_FATAL_FAILURE(writeDictionary("SynMany",
                                          {{"color", "a hue"}, {"shade", "a dark area"}, {"zebra", "striped"}},
                                          {{"colour", "color"}, {"colour", "shade"}}));
  Dictionary dict;
  ASSERT_NO_FATAL_FAILURE(openIndexed(dict, "SynMany"));
  EXPECT_EQ(lookedUp(dict, "colour"), "color\na hue\n\nshade\na dark area");
  EXPECT_EQ(resolveThenRead(dict, "colour"), "color\na hue\n\nshade\na dark area");
}

// JMdict files a kana reading as a synonym of each kanji spelling (docs/dictionary.md).
TEST_F(DictionaryTest, APrefixHitOnASynonymOfSeveralHeadwordsListsThemAll) {
  ASSERT_NO_FATAL_FAILURE(writeDictionary("SynKana", {{"橋", "bridge"}, {"箸", "chopsticks"}, {"端", "edge"}},
                                          {{"はし", "端"}, {"はし", "橋"}, {"はし", "箸"}}));
  Dictionary dict;
  ASSERT_NO_FATAL_FAILURE(openIndexed(dict, "SynKana"));
  DictPrefixMatch m;
  ASSERT_TRUE(dict.resolvePrefixes("はしを", m));
  ASSERT_EQ(m.count, 1);
  EXPECT_EQ(m.hits[0].runBytes, 6);
  std::string definition;
  ASSERT_TRUE(dict.readPrefixDefinitions(m, definition));
  EXPECT_EQ(definition, "端\nedge\n\n橋\nbridge\n\n箸\nchopsticks");
}

TEST_F(DictionaryTest, TwoSynonymRecordsIntoOneRunListItOnce) {
  ASSERT_NO_FATAL_FAILURE(writeDictionary("SynSameRun", {{"银行", "bank"}, {"银行", "row of shops"}, {"钱", "money"}},
                                          {{"銀行", "银行", 0}, {"銀行", "银行", 1}, {"銀行", "钱"}}));
  Dictionary dict;
  ASSERT_NO_FATAL_FAILURE(openIndexed(dict, "SynSameRun"));
  DictPrefixMatch m;
  ASSERT_TRUE(dict.resolvePrefixes("銀行", m));
  std::string definition;
  ASSERT_TRUE(dict.readPrefixDefinitions(m, definition));
  EXPECT_EQ(definition, "银行\nbank\n\n银行\nrow of shops\n\n钱\nmoney");
}

TEST_F(DictionaryTest, ASynonymTargetAnotherHitListsIsListedOnce) {
  ASSERT_NO_FATAL_FAILURE(
      writeDictionary("SynOverlap", {{"大", "big"}, {"學", "study"}}, {{"大學", "學"}, {"大學", "大"}}));
  Dictionary dict;
  ASSERT_NO_FATAL_FAILURE(openIndexed(dict, "SynOverlap"));
  DictPrefixMatch m;
  ASSERT_TRUE(dict.resolvePrefixes("大學", m));
  EXPECT_EQ(hitsOf(m), (HitList{{"學", 6}, {"大", 3}}));
  std::string definition;
  ASSERT_TRUE(dict.readPrefixDefinitions(m, definition));
  EXPECT_EQ(definition, "學\nstudy\n\n大\nbig");
}

// .sidx sample 1 opens at record 256: at 254 fillers the word's records end before it, at 255 they straddle it.
TEST_F(DictionaryTest, ASynonymsRecordsAreAllFoundAcrossASample) {
  for (const int leading : {254, 255, 256}) {
    std::vector<SynonymSpec> synonyms;
    for (int i = 0; i < leading; i++) synonyms.push_back({"a" + std::to_string(1000 + i), "橋"});
    synonyms.push_back({"はし", "端"});
    synonyms.push_back({"はし", "箸"});
    const std::string folder = "SynAcross" + std::to_string(leading);
    ASSERT_NO_FATAL_FAILURE(
        writeDictionary(folder, {{"橋", "bridge"}, {"箸", "chopsticks"}, {"端", "edge"}}, synonyms));
    Dictionary dict;
    ASSERT_NO_FATAL_FAILURE(openIndexed(dict, folder));
    DictPrefixMatch m;
    ASSERT_TRUE(dict.resolvePrefixes("はしを", m)) << leading;
    std::string definition;
    ASSERT_TRUE(dict.readPrefixDefinitions(m, definition)) << leading;
    EXPECT_EQ(definition, "端\nedge\n\n箸\nchopsticks") << leading;
    EXPECT_EQ(lookedUp(dict, "はし"), "端\nedge\n\n箸\nchopsticks") << leading;
  }
}

TEST_F(DictionaryTest, ASynonymListsAtMostEightEntries) {
  std::vector<HeadwordSpec> headwords;
  std::vector<SynonymSpec> synonyms;
  for (int i = 0; i < 10; i++) {
    headwords.push_back({"word" + std::to_string(i), "meaning" + std::to_string(i)});
    synonyms.push_back({"あ", "word" + std::to_string(i)});
  }
  ASSERT_NO_FATAL_FAILURE(writeDictionary("SynCap", headwords, synonyms));
  Dictionary dict;
  ASSERT_NO_FATAL_FAILURE(openIndexed(dict, "SynCap"));
  const std::string definition = lookedUp(dict, "あ");
  EXPECT_NE(definition.find("meaning7"), std::string::npos);
  EXPECT_EQ(definition.find("meaning8"), std::string::npos);
}

// The word screen keeps one DictPrefixMatch across searches: the next word must not inherit a synonym's records.
TEST_F(DictionaryTest, AReusedMatchForgetsTheSynonymItHeld) {
  ASSERT_NO_FATAL_FAILURE(writeDictionary("SynReused", {{"橋", "bridge"}, {"箸", "chopsticks"}, {"端", "edge"}},
                                          {{"はし", "端"}, {"はし", "橋"}, {"はし", "箸"}}));
  Dictionary dict;
  ASSERT_NO_FATAL_FAILURE(openIndexed(dict, "SynReused"));
  DictPrefixMatch m;
  ASSERT_TRUE(dict.resolvePrefixes("はしを", m));
  ASSERT_TRUE(dict.resolvePrefixes("箸を", m));
  std::string definition;
  ASSERT_TRUE(dict.readPrefixDefinitions(m, definition));
  EXPECT_EQ(definition, "箸\nchopsticks");
}

// The search is the gate on JMdict (docs/future_work/cjk.md): more targets must not cost it a read.
TEST_F(DictionaryTest, ASynonymsOtherTargetsCostTheSearchNothing) {
  const std::vector<HeadwordSpec> headwords = {{"橋", "bridge"}, {"箸", "chopsticks"}, {"端", "edge"}};
  ASSERT_NO_FATAL_FAILURE(writeDictionary("SynCostOne", headwords, {{"はし", "端"}}));
  ASSERT_NO_FATAL_FAILURE(writeDictionary("SynCostThree", headwords, {{"はし", "端"}, {"はし", "橋"}, {"はし", "箸"}}));
  Dictionary one;
  ASSERT_NO_FATAL_FAILURE(openIndexed(one, "SynCostOne"));
  Dictionary three;
  ASSERT_NO_FATAL_FAILURE(openIndexed(three, "SynCostThree"));
  DictPrefixMatch a;
  DictPrefixMatch b;
  ASSERT_TRUE(one.resolvePrefixes("はしを", a));
  ASSERT_TRUE(three.resolvePrefixes("はしを", b));
  EXPECT_EQ(a.probes, b.probes);
  EXPECT_EQ(a.reads, b.reads);
}

}  // namespace
